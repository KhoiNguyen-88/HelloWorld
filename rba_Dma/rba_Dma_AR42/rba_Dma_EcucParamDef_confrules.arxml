AUTOSAR XML (schema 4-2-2)
package /RB/RBA/rba_Dma/EcucModuleDefs
  module definition rba_Dma [0..1]: category=VENDOR_SPECIFIC_MODULE_DEFINITION, post-build-variant-support=true, variants pre-compile  # MCAL Dma | Container for DMA configuration.
    container rba_Dma_Cfg [0..1]: multiplicity set at pre-compile  # DMA configuration | Defines one data set of post-build configuration. Which of these data sets is actually active is controlled by EcuM. Data sets can only be switched at initialization time. Multiple instances of such containers with same identifier are automatically merged. Data set ID is the short name of this container.
      container rba_Dma_Ch [0..*]: multiplicity set at pre-compile, post-build-variant-multiplicity=true  # DMA channel | Container for a DMA channel configuration
        enumeration rba_Dma_1_Unit: {SB0, SB1}, origin=RB:0.1.0:2011-04-19, post-build-variant-value=true, set at pre-compile  # Unit | Selects the DMA module (sub block). Range: IFX Dev2: 0 IFX Dev3: 0 IFX Dev4: 0 JDP Dev2: 0 JDP Dev4: 0, 1 ST Dev3+: 0, 1
        enumeration rba_Dma_2_Ch: {CH0, CH1, CH2, CH3, CH4, CH5, CH6, CH7, CH8, CH9, CH10, CH11, CH12, CH13, CH14, CH15, CH16, CH17, CH18, CH19, CH20, CH21, CH22, CH23, CH24, CH25, CH26, CH27, CH28, CH29, CH30, CH31, CH32, CH33, CH34, CH35, CH36, CH37, CH38, CH39, CH40, CH41, CH42, CH43, CH44, CH45, CH46, CH47, CH48, CH49, CH50, CH51, CH52, CH53, CH54, CH55, CH56, CH57, CH58, CH59, CH60, CH61, CH62, CH63, CH64, CH65, CH66, CH67, CH68, CH69, CH70, CH71, CH72, CH73, CH74, CH75, CH76, CH77, CH78, CH79, CH80, CH81, CH82, CH83, CH84, CH85, CH86, CH87, CH88, CH89, CH90, CH91, CH92, CH93, CH94, CH95, CH96, CH97, CH98, CH99, CH100, CH101, CH102, CH103, CH104, CH105, CH106, CH107, CH108, CH109, CH110, CH111, CH112, CH113, CH114, CH115, CH116, CH117, CH118, CH119, CH120, CH121, CH122, CH123, CH124, CH125, CH126, CH127}, origin=RB:0.1.0:2011-04-19, post-build-variant-value=true, set at pre-compile  # Channel | Selects the DMA channel to be configured. Range: IFX Dev2: 0 .. 31 IFX Dev3: 0 .. 63 IFX Dev4: 0 .. 127 JDP Dev2: 0 .. 31 JDP Dev4: 0 .. 63 ST Dev3+ move engine 0: 0 .. 31 ST Dev3+ move engine 1: 0 .. 63
        enumeration rba_Dma_3_TrgSrc [0..1]: multiplicity set at pre-compile, origin=RB:0.1.0:2011-07-22, post-build-variant-multiplicity=true, post-build-variant-value=true, set at pre-compile  # Trigger source | Trigger source selection. For IFX this tag is not evaluated as the actual trigger source is configured outside the DMA module by using the SRN register associated to the trigger source. JDP devices use this tag to configure the actual trigger source. Keep in mind that not all trigger sources can be connected to one specific channel, cross-check controller manual for valid settings.
          ADC_SAR_{0..10}_EOC
          ADC_SAR_B_EOC
          ADC_SAR10_0_EOC
          ADC_SAR10_1_EOC
          ADC_SD_{0..9}_EOC
          DSPI_{0..9}_CMD
          DSPI_12_CMD
          DSPI_{0..9}_RX
          DSPI_12_RX
          DSPI_{0..9}_TX
          DSPI_12_TX
          GTM_ATOM0_IRQ{0..3}
          GTM_ATOM1_IRQ0  # GTM_ATOM0_IRQ0
          GTM_ATOM1_IRQ{1..3}
          GTM_ATOM2_IRQ{0..3}
          GTM_ATOM3_IRQ{0..3}
          GTM_ATOM4_IRQ{0..3}
          GTM_ATOM5_IRQ{0..3}
          GTM_ATOM6_IRQ{0..3}
          GTM_ATOM7_IRQ{0..3}
          GTM_ATOM8_IRQ{0..3}
          GTM_MCS0_IRQ{0..7}
          GTM_MCS1_IRQ{0..7}
          GTM_MCS2_IRQ{0..7}
          GTM_MCS3_IRQ{0..7}
          GTM_MCS4_IRQ{0..7}
          GTM_MCS5_IRQ{0..7}
          GTM_SPE{0..3}
          GTM_TIM0_IRQ{0..7}
          GTM_TIM1_IRQ{0..7}
          GTM_TIM2_IRQ{0..7}
          GTM_TIM3_IRQ{0..7}
          GTM_TIM4_IRQ{0..7}
          GTM_TIM5_IRQ{0..7}
          GTM_TOM0_IRQ{0..7}
          GTM_TOM1_IRQ{0..7}
          GTM_TOM2_IRQ{0..7}
          GTM_TOM3_IRQ{0..7}
          GTM_TOM4_IRQ{0..7}
          GTM_PSM0_IRQ{0..7}
          GTM_PSM1_IRQ{0..7}
          I2C_0_RX
          I2C_0_TX
          I2C_1_RX
          I2C_1_TX
          LINFlexD_{0..16}_RX
          LINFlexD_{0..16}_TX
          MCAN_1
          MCAN_2
          PSI5_0_CH0_RX_PSI5
          PSI5_0_CH0_RX_SENT
          PSI5_0_CH1_RX_PSI5
          PSI5_0_CH1_RX_SENT
          PSI5_0_CH2_RX_PSI5
          PSI5_0_CH2_RX_SENT
          PSI5_1_CH0_RX_PSI5
          PSI5_1_CH0_RX_SENT
          PSI5_1_CH1_RX_PSI5
          PSI5_1_CH1_RX_SENT
          PSI5_S
          PSI5_S_PS
          PSI5_S_RX
          PSI5_S_TX
          SENT_0_RX_FAST
          SENT_0_RX_SLOW
          SENT_1_RX_FAST
          SENT_1_RX_SLOW
          SIPI_CH{0..3}
          SIUL2_REQ{0..15}
          AMU0
          AMU1
          Always_on
        string rba_Dma_4_Irq [0..1]: multiplicity set at pre-compile, origin=RB:0.1.0:2011-05-09, post-build-variant-multiplicity=true, post-build-variant-value=true, set at pre-compile, regular-expression=[A-Za-z_][A-Za-z0-9_]*  # Interrupt generation | currently not supported by configuration
        string rba_Dma_5_LinkCh [0..1]: multiplicity set at pre-compile, origin=RB:3.0.0:2014-04-23, post-build-variant-multiplicity=true, post-build-variant-value=true, set at pre-compile, regular-expression=[A-Za-z_][A-Za-z0-9_]*  # Target linked channel | Specify the target DMA channel name which shall be triggered by this channel.
    container rba_Dma_General [0..1]: multiplicity set at pre-compile  # General configuration | General DMA configuration valid for all post build configurations.
      boolean rba_Dma_ActErrDet [0..1]: multiplicity set at pre-compile, origin=RB:0.1.0:2011-04-19, set at pre-compile  # Development error detection | Enables/disables the detection and notification of development errors. If this parameter is enabled, then extended error checking is performed during runtime; any errors detected by these checks are reported to the Det module. This feature should be switched off in series software.
      enumeration rba_Dma_ErrReaction [0..1]: multiplicity set at pre-compile, origin=RB:2.1.0:2014-02-19, set at pre-compile  # Error Reaction | Selects how rba_Dma shall handle internal DMA errors. If Count/Det is selected a counter is raised and a Det entry will be generated if activated by rba_Dma_ActErrDet. If Reset is selected a configuration of a suitable rba_Reset event is necessary.
        None  # no reaction
        Det  # Count/Det
        Reset  # trigger a Reset
      boolean rba_Dma_VrsnInfoApi [0..1]: multiplicity set at pre-compile, origin=RB:0.1.0:2011-04-19, set at pre-compile  # Version information API | Enables/disables the GetVersionInfo() API. This functionality can be used e.g. for providing version information to test equipment. -->This feature is currently not supported <--

AUTOSAR XML (schema 4-0-3)
package /RB/RBA/rba_Dma/Documentations
  documentation DeliveryNote: category=ARREP  # Delivery Note
    documentation-content:
      5 x chapter:
        DeliveryNoteGeneral: category=BODY  # General delivery information
          table tgroup=tbody=[[p=l-1=e=Delivery date:, p=l-1=2019-01-31], [p=l-1=e=Abstract of changes:, [l-1=RQONE01417460 - Support for Ifx_Dev3_40nm Device, l-1=RQONE01296572 - MoInitCheck implementation for rba_Dma]], [p=l-1=e=Restrictions:, p=l-1=JDP: It is possible to configure two DMA channels to the same request source, however this is not allowed according to JDP specification. In cases this is needed use the interface rba_Dma_SwtMux() to activate only one connection at once, disable all not needed connections. When switching, first diable the active connection, than enable another one.], [p=l-1=e=Supported devices:, p=l-1=see MCAL delivery note for details], [p=l-1=e=Developer:, p=l-1=Amuthavalli Rangasamy(RBEI/EBB6)], [p=l-1=e=Requirements to:, p=l-1=Thillai Maharajan M (RBEI/EBB6)]]:
            table caption DeliveryNoteGeneralInfo  # General delivery information
        DeliveryNoteChanges  # Changes
          table tgroup={thead=row=[p=l-1=Id, p=l-1=Headline], tbody=[[p=l-1=RQONE01417460, p=l-1=Support for Ifx_Dev3_40nm Device], [p=l-1=RQONE01296572, p=l-1=MoInitCheck implementation for rba_Dma]]}:
            table caption DeliveryNoteChangesTable
        DeliveryNoteUpdate  # Update hints
          5 x chapter:
            DeliveryNoteUpdateComp  # Necessary component updates
            DeliveryNoteUpdateConf: list=[]  # Necessary configuration changes
            DeliveryNoteUpdateCode  # Necessary code changes
            DeliveryNoteUpdateCalib  # Necessary calibration changes
            DeliveryNoteUpdateTools: list=[p=l-1=AEEE-Pro 2018.1.2, p=l-1=Rhapsody 8.3]  # Necessary tool versions
        DeliveryNoteDeprecated: list=item=p=l-1=The deprecated function void rba_Dma_Shutdown(void) has been disabled. It can be re-enabled by setting RBA_DMA_SHUTDOWN_API to STD_ON in the file rba_Dma_MemMap.h.  # Deprecated functionality
        DeliveryNoteAdditional: list=[p=l-1=uint8_least rba_Dma_GetUnitNum (rba_Dma_Id_ten const idChan_cen) is deprecated and should be replaced by Std_ReturnType rba_Dma_GetUnitNr() or by rba_Dma_GetIdx()., p=l-1=uint8_least rba_Dma_GetChanNum (rba_Dma_Id_ten const idChan_cen) is deprecated and should be replaced by Std_ReturnType rba_Dma_GetChNr() or by rba_Dma_GetIdx().]  # Additional hints

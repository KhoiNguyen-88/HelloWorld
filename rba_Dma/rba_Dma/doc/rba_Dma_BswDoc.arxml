AUTOSAR XML (schema 4-0-3)
package /RB/RBA/rba_Dma/BswModuleDescriptions
  bsw module description rba_Dma  # Direct Memory Access
    sw-component-documentation:
      sw feature def BswDocDef
        5 x chapter:
          BswDocDefPurpose: p=l-1=Purpose of this document is to get an overview of the SW component rba_Dma, its interactions and services..  # Purpose
          BswDocDefIntroduction: p=l-1=rba_Dma takes care for basic initialisation of all configured microcontroller DMA resources.  # Introduction
          BswDocDefInteraction: p=l-1=rba_Dma does not push any information to other modules, it receives information from any module who needs a DMA channel.  # Interaction
          BswDocDefFeatures  # Features
          BswDocDefSubstructure  # Substructure
      sw feature desc BswDocDesc
        chapter BswDocDescBehaviorNormalMode: p=l-1=rba_Dma has no cyclic runtime functions, all services are called on demand.  # Behavior in normal mode
        chapter BswDocDescBehaviorInitialization: p=l-1=To initialise rba_Dma and the Dma hardware call the function void rba_Dma_Init() with the desired post build variant parameter. rba_Dma_Init() should be called before any other process which uses DMA resources, like (Ds)Adc, Spi, rba_Msc or complex driver functions.  # Behavior in initialization
        chapter BswDocDescBehaviorShutdown  # Behavior in shutdown
      sw calibration notes BswDocCalibration
        chapter BswDocCalibrationMeasurements  # Measurements
        chapter BswDocCalibrationParameters: p=l-1=rba_Dma provides no calibration features.  # Calibration parameters
      9 x chapter:
        BswDocGlossary  # Glossary
        BswDocArDeviations  # Deviations from AUTOSAR specification
          chapter BswDocArDeviationsPermanent  # Permanent deviations
          chapter BswDocArDeviationsTemporary  # Temporary deviations
        BswDocInterfaces  # Interface reference
          5 x chapter:
            BswDocInterfaceEcuc  # Configuration interface
            BswDocInterfaceCalibration  # Calibration interface
              chapter BswDocInterfaceCalibrationMeasurements  # Measurements
              chapter BswDocInterfaceCalibrationParameters: p=l-1=-  # Calibration parameters
            BswDocInterfaceRte  # RTE interface
              6 x chapter:
                BswDocInterfaceRteClientServer  # Client/server interfaces
                BswDocInterfaceRteData  # Data interfaces
                BswDocInterfaceRteModeSwitch  # Mode switch interfaces
                BswDocInterfaceRteTrigger  # Trigger interfaces
                BswDocInterfaceRtePPorts  # Provided ports
                BswDocInterfaceRteRPorts  # Required ports
            BswDocInterfaceC  # C interface
              7 x chapter:
                BswDocInterfaceCProvidedFunctions  # Provided functions
                  17 x chapter:
                    rba_Dma_GetIdx
                      table tgroup=tbody=[[p=l-1=Service name:, p=l-1=rba_Dma_GetIdx], [p=l-1=Syntax:, verbatim=l-5=Std_ReturnType rba_Dma_GetIdx (rba_Dma_Id_ten const idChan_cen, uint8* const ptrUnitVal_cpu8, uint8* const ptrChVal_cpu8)], [p=l-1=Service ID [hex]:, p=l-1=na], [p=l-1=Sync/Async:, p=l-1=Synchronous], [p=l-1=Reentrancy:, p=l-1=Reentrant], [p=l-1=Parameters (in):, p=l-1=idChan_cen: channel identifier, must be of type rba_Dma_Id_ten.], [p=l-1=Parameters (inout):, p=l-1=-], [p=l-1=Parameters (out):, [l-1=ptrUnitVal_cpu8: pointer to DMA unit (i.e. move engine) storage/return variable, l-1=ptrChVal_cpu8: pointer to DMA channel storage/return variable]], [p=l-1=Return value:, p=l-1=Std_ReturnType: Returns E_OK if the resolving was successful, else E_NOT_OK], [p=l-1=Description:, p=l-1=Resolves short name to actually configured DMA move engine and DMA channel number. The function rba_Dma_GetIdx returns E_NOT_OK if the parameter idChen_cen is not configured in the currently active post build variant.]]:
                        table caption ID04002511327742
                    rba_Dma_GetUnitNr
                      table tgroup=tbody=[[p=l-1=Service name:, p=l-1=rba_Dma_GetUnitNr], [p=l-1=Syntax:, verbatim=l-5=Std_ReturnType rba_Dma_GetUnitNr (rba_Dma_Id_ten const idChan_cen, uint8* const ptrUnitVal_cpu8)], [p=l-1=Service ID [hex]:, p=l-1=na], [p=l-1=Sync/Async:, p=l-1=Synchrnous], [p=l-1=Reentrancy:, p=l-1=Reentrant], [p=l-1=Parameters (in):, p=l-1=idChan_cen: channel identifier, must be of type rba_Dma_Id_ten.], [p=l-1=Parameters (inout):, p=l-1=-], [p=l-1=Parameters (out):, p=l-1=ptrUnitVal_cpu8: pointer to DMA unit (i.e. move engine) storage/return variable], [p=l-1=Return value:, p=l-1=Std_ReturnType: Returns E_OK if the resolving was successful, else E_NOT_OK], [p=l-1=Description:, p=l-1=Resolves short name to actually configured DMA move engine number. The function rba_Dma_GetUnitNr returns E_NOT_OK if the parameter idChen_cen is not configured in the currently active post build variant.]]:
                        table caption ID67214149922846  # rba_Dma_GetUnitNr
                    rba_Dma_GetChNr
                      table tgroup=tbody=[[p=l-1=Service name:, p=l-1=rba_Dma_GetChNr], [p=l-1=Syntax:, verbatim=l-5=Std_ReturnType rba_Dma_GetChNr (rba_Dma_Id_ten const idChan_cen, uint8* const ptrChVal_cpu8)], [p=l-1=Service ID [hex]:, p=l-1=na], [p=l-1=Sync/Async:, p=l-1=Synchronous], [p=l-1=Reentrancy:, p=l-1=Reentrant], [p=l-1=Parameters (in):, p=l-1=idChan_cen: channel identifier, must be of type rba_Dma_Id_ten.], [p=l-1=Parameters (inout):, p=l-1=-], [p=l-1=Parameters (out):, p=l-1=ptrChVal_cpu8: pointer to DMA unit (i.e. move engine) storage/return variable], [p=l-1=Return value:, p=l-1=Std_ReturnType: Returns E_OK if the resolving was successful, else E_NOT_OK], [p=l-1=Description:, p=l-1=Resolves short name to actually configured DMA channel number. The function rba_Dma_GetChNr returns E_NOT_OK if the parameter idChen_cen is not configured in the currently active post build variant.]]:
                        table caption ID11237576843991  # rba_Dma_GetChNr
                    rba_Dma_EnblCh
                      table tgroup=tbody=[[p=l-1=Service name:, p=l-1=rba_Dma_EnblCh], [p=l-1=Syntax:, verbatim=l-5=Std_ReturnType rba_Dma_EnblCh (rba_Dma_Id_ten const idChan_cen)], [p=l-1=Service ID [hex]:, p=l-1=na], [p=l-1=Sync/Async:, p=l-1=Synchronous], [p=l-1=Reentrancy:, p=l-1=Reentrant], [p=l-1=Parameters (in):, p=l-1=idChan_cen: channel identifier, must be of type rba_Dma_Id_ten.], [p=l-1=Parameters (inout):, p=l-1=-], [p=l-1=Parameters (out):, p=l-1=-], [p=l-1=Return value:, p=l-1=Std_ReturnType: Returns E_OK if the resolving was successful, else E_NOT_OK], [p=l-1=Description:, p=l-1=Enables the hardware trigger of the selected DMA channel.]]:
                        table caption ID82191972811090  # rba_Dma_EnblCh
                    rba_Dma_DsblCh
                      table tgroup=tbody=[[p=l-1=Service name:, p=l-1=rba_Dma_DsblCh], [p=l-1=Syntax:, verbatim=l-5=Std_ReturnType rba_Dma_DsblCh (rba_Dma_Id_ten const idChan_cen)], [p=l-1=Service ID [hex]:, p=l-1=na], [p=l-1=Sync/Async:, p=l-1=Synchrnous], [p=l-1=Reentrancy:, p=l-1=Reentrant], [p=l-1=Parameters (in):, p=l-1=idChan_cen: channel identifier, must be of type rba_Dma_Id_ten.], [p=l-1=Parameters (inout):, p=l-1=-], [p=l-1=Parameters (out):, p=l-1=-], [p=l-1=Return value:, p=l-1=Std_ReturnType Returns E_OK if the resolving was successful, else E_NOT_OK], [p=l-1=Description:, p=l-1=Disables the hardware trigger of the selected DMA channel. Beware: The channel can still be triggered by software!]]:
                        table caption ID73853549934201  # rba_Dma_DsblCh
                    rba_Dma_MoInitCheck
                      table tgroup=tbody=[[p=l-1=Service name:, p=l-1=rba_Dma_MoInitCheck], [p=l-1=Syntax:, verbatim=l-5=Std_ReturnType rba_Dma_MoInitCheck(const rba_Dma_ConfigType* ConfigPtr_pc)], [p=l-1=Service ID [hex]:, p=l-1=na], [p=l-1=Sync/Async:, p=l-1=Synchronous], [p=l-1=Reentrancy:, p=l-1=Reentrant], [p=l-1=Parameters (in):, p=l-1=ConfigPtr_pc], [p=l-1=Parameters (inout):, p=l-1=-], [p=l-1=Parameters (out):, p=l-1=-], [p=l-1=Return value:, [l-1=Std_ReturnType, l-1=E_OK : If input pointer is identical to configured postbuild pointer., l-1=E_NOT_OK: In case the pointers are different from one another.]], [p=l-1=Description:, [l-1=This function is for MONITORING components (MoF) only. A Service to compare the postbuild pointer which has been set during init with the input pointer as a direct access to Mcal]]]:
                        table caption ID82191972811091  # rba_Dma_MoInitCheck
                    rba_Dma_TrgCh
                      table tgroup=tbody=[[p=l-1=Service name:, p=l-1=rba_Dma_TrgCh], [p=l-1=Syntax:, verbatim=l-5=void rba_Dma_TrgCh (uint8 idxUnit_u8, uint8 idxCh_u8)], [p=l-1=Service ID [hex]:, p=l-1=na], [p=l-1=Sync/Async:, p=l-1=Synchronous], [p=l-1=Reentrancy:, p=l-1=Reentrant], [p=l-1=Parameters (in):, [l-1=idxUnit_u8: move engine index, l-1=idxCh_u8: channel index]], [p=l-1=Parameters (inout):, p=l-1=-], [p=l-1=Parameters (out):, p=l-1=-], [p=l-1=Return value:, p=l-1=-], [p=l-1=Description:, p=l-1=This function triggers a DMA transaction at the selected DMA channel. The function parameters are not checked for valid contents so the user has to take care that rba_Dma_TrgCh() is only called with properly initialised module and channel indices. This is normally done by using the function rba_Dma_GetIdx() and proper evaluation of its return value.]]:
                        table caption ID16331846070106  # rba_Dma_TrgCh
                    rba_Dma_RstCh
                      table tgroup=tbody=[[p=l-1=Service name:, p=l-1=rba_Dma_RstCh], [p=l-1=Syntax:, verbatim=l-5=Std_ReturnType rba_Dma_RstCh (rba_Dma_Id_ten const idChan_cen)], [p=l-1=Service ID [hex]:, p=l-1=na], [p=l-1=Sync/Async:, p=l-1=Synchronous], [p=l-1=Reentrancy:, p=l-1=Reentrant], [p=l-1=Parameters (in):, p=l-1=idChan_cen: channel identifier, must be of type rba_Dma_Id_ten.], [p=l-1=Parameters (inout):, p=l-1=-], [p=l-1=Parameters (out):, p=l-1=-], [p=l-1=Return value:, p=l-1=Std_ReturnType: Returns E_OK if the resolving was successful, else E_NOT_OK], [p=l-1=Description:, [l-1=This function does different things depending on the used hardware:, l-1=IFX controllers: DMA channel is reset by HW means., l-1=JDP controllers: DMA channel cannot be directly reset here, so this function only disables the HW trigger input and clears the channel specific errors.]]]:
                        table caption ID16331846070107  # rba_Dma_RstCh
                    rba_Dma_SwtMux: verbatim=l-5=void AnyDmaIsr(void) { if (E_OK = rba_Dma_SwtMux( rba_Dma_Id_ten ChannelId, TRUE )) { // ... } }
                      table tgroup=tbody=[[p=l-1=Service name:, p=l-1=rba_Dma_SwtMux], [p=l-1=Syntax:, verbatim=l-5=Std_ReturnType rba_Dma_SwtMux(rba_Dma_Id_ten const idChan_cen, boolean const swtOnOff_cb)], [p=l-1=Service ID [hex]:, p=l-1=na], [p=l-1=Sync/Async:, p=l-1=Synchronous], [p=l-1=Reentrancy:, p=l-1=Reentrant], [p=l-1=Parameters (in):, [l-1=idChan_cen: channel identifier, must be of type rba_Dma_Id_ten., l-1=swtOnOff_cb: switch direction, TRUE = on, FALSE = off]], [p=l-1=Parameters (inout):, p=l-1=-], [p=l-1=Parameters (out):, p=l-1=-], [p=l-1=Return value:, p=l-1=Std_ReturnType: Returns E_OK if the resolving was successful, else E_NOT_OK], [p=l-1=Description:, p=l-1=This function can be used to enable or disable a DMA MUX input on JDP controllers, it does nothing on IFX controllers and will return E_OK.]]:
                        table caption ID29065446092798  # rba_Dma_SwtMux
                    rba_Dma_GetChSts
                      table tgroup=tbody=[[p=l-1=Service name:, p=l-1=rba_Dma_GetChSts], [p=l-1=Syntax:, verbatim=l-5=Std_ReturnType rba_Dma_GetChSts(rba_Dma_Id_ten const idChan_cen, uint32 * const stErr_pu32)], [p=l-1=Service ID [hex]:, p=l-1=na], [p=l-1=Sync/Async:, p=l-1=Synchronous], [p=l-1=Reentrancy:, p=l-1=Reentrant], [p=l-1=Parameters (in):, p=l-1=idChan_cen: channel identifier, must be of type rba_Dma_Id_ten.], [p=l-1=Parameters (inout):, p=l-1=-], [p=l-1=Parameters (out):, p=l-1=uint32 * const stErr_pu32 DMA channel status information], [p=l-1=Return value:, p=l-1=Std_ReturnType: Returns E_OK if the resolving was successful, else E_NOT_OK], [p=l-1=Description:, [l-1=stErr_pu32 provides following error information:, l-1=RBA_DMA_GETCHSTS_CHACTV_ERR_POS: this bit is set if the channel is active when the function is called, l-1=RBA_DMA_GETCHSTS_REQLOST_ERR_POS: this bit is set if a request lost event was detected (IFX only), l-1=The function will return E_NOT_OK if the DMA channel identifier resolving fails, no valid error information is returned in this case. If the resolving is successful the function will return E_OK regardless of the actual channel status (i.e. it will return E_OK even if there are channel errors reported through stErr_pu32). The function does not check the move engine status registers, the monitoring of such kind of errors is done in a different way (error interrupt or rba_Emm actions). IFX only: If there is a request lost event detected the function will reset this event to prevent a false positve detection in the next function call.]]]:
                        table caption ID29065446092799  # rba_Dma_GetChSts
                    rba_Dma_AckIrq: verbatim=l-5=void AnyDmaIsr(void) { if (E_OK = rba_Dma_AckIrq( rba_Dma_Id_ten ChannelId ) { // ... } }
                      table tgroup=tbody=[[p=l-1=Service name:, p=l-1=rba_Dma_AckIrq], [p=l-1=Syntax:, verbatim=l-5=Std_ReturnType rba_Dma_AckIrq(rba_Dma_Id_ten const idChan_cen)], [p=l-1=Service ID [hex]:, p=l-1=na], [p=l-1=Sync/Async:, p=l-1=Synchronous], [p=l-1=Reentrancy:, p=l-1=Reentrant], [p=l-1=Parameters (in):, p=l-1=idChan_cen: channel identifier, must be of type rba_Dma_Id_ten.], [p=l-1=Parameters (inout):, p=l-1=-], [p=l-1=Parameters (out):, p=l-1=-], [p=l-1=Return value:, p=l-1=Std_ReturnType: Returns E_OK if the resolving was successful, else E_NOT_OK], [p=l-1=Description:, p=l-1=This function acknowledges any DMA triggered interrupt request on JDP controllers, it does nothing on IFX controllers and will return E_OK.]]:
                        table caption ID28295375945401  # rba_Dma_AckIrq
                    rba_Dma_SetUpCh:
                      note=p=l-1=rba_Dma_SetUpCh() does no address modification which might basically be necessary if you have e.g. 16 bit transfers on JDP controllers.
                      p=l-1=Example:
                      verbatim=l-5=static rba_Dma_SetUpCh_tst Testcd_rba_Dma_dataDmaCh1_st; static uint32 Testcd_rba_Dma_stErrDma1_u32; static Std_ReturnType Testcd_rba_Dma_xRetDma1Sts; // DMA target buffer // hint: this buffer uses the correct alignment to be used as destination in a circular/ring buffer configuration static RBA_MEMLAY_USE_RAM0_A64 (volatile uint32, TestCd_rba_Dma_tiDmaTestChan0_avu32[16]); // initialise DMA channel using rba_Dma_SetUpCh(), fill buffer with TBU0 timestamps #ifdef RBA_DMA_DMATESTCHAN1_CONF Testcd_rba_Dma_dataDmaCh1_st.adrSrc_pv = (void*)(uint32)&GTM.TBU_CH0_BASE Testcd_rba_Dma_dataDmaCh1_st.adrDest_pv = (void*)(uint32)&TestCd_rba_Dma_tiDmaTestChan0_avu32[0]; Testcd_rba_Dma_dataDmaCh1_st.numTrig_u32 = 1; Testcd_rba_Dma_dataDmaCh1_st.numMoves_u32 = 16; Testcd_rba_Dma_dataDmaCh1_st.swtEnaReq_b = FALSE; Testcd_rba_Dma_dataDmaCh1_st.swtSize_u8 = 2; Testcd_rba_Dma_dataDmaCh1_st.swtChTrig_u8 = 0x80; // enable swtOptions2_u32 options Testcd_rba_Dma_dataDmaCh1_st.swtIncSrc_b = TRUE; // increment source address Testcd_rba_Dma_dataDmaCh1_st.swtIncDest_b = TRUE; // increment destination address Testcd_rba_Dma_dataDmaCh1_st.swtOptions2_u32 = 0x90; Testcd_rba_Dma_xRetDma1SetUp = rba_Dma_SetUpCh(rba_Dma_DmaTestChan1, &Testcd_rba_Dma_dataDmaCh1_st, &Testcd_rba_Dma_stErrDma1_u32); #endif
                      p=l-1=The following table lists valid combinations of swtChTrig_u8-bits
                      p=l-1=(1) If channel is a link-target (LINK_TARGET is set) the HW trigger is always enabled.
                      p=l-1=(2) If channel is in ring-buffer mode the HW trigger is always left enabled
                      p=l-1=(3) The bit KEEP_HWTRIGGER is only evaluated if either ENBL_HW_TRG or LINK_TARGET is set
                      p=l-1=(4) Use TRG_LINK_INNER in combination with circular buffers
                      note=[l-1=- The setting of the two bits RBA_DMA_SETUPCH_DECREMENT_SRC_POS or RBA_DMA_SETUPCH_DECREMENT_DST_POS has no influence on this table., l-1=- If ring buffer mode is only activated for source or destination the settings shown in the row 'ENA_RING_BUF' are still valid]
                      table tgroup=tbody=[[p=l-1=Service name:, p=l-1=rba_Dma_SetUpCh], [p=l-1=Syntax:, verbatim=l-5=Std_ReturnType rba_Dma_SetUpCh (rba_Dma_Id_ten const idChan_cen, rba_Dma_SetUpCh_tst const * const adrConfig_cpcst, uint32 * const stErr_cpu32)], [p=l-1=Service ID [hex]:, p=l-1=na], [p=l-1=Sync/Async:, p=l-1=Synchronous], [p=l-1=Reentrancy:, p=l-1=Reentrant (but not with the same channel ID!)], [p=l-1=Parameters (in):, [l-1=idChan_cen: channel identifier, must be of type rba_Dma_Id_ten., l-1=adrConfig_cpcst: configuration structure of type rba_Dma_SetUpCh_tst]], [p=l-1=Parameters (inout):, p=l-1=-], [p=l-1=Parameters (out):, p=l-1=stErr_cpu32: returns error information. This parameter is updated on every function call, zero means successful DMA channel programming.], [p=l-1=Return value:, p=l-1=Std_ReturnType: Returns E_OK if channel set-up was done, else E_NOT_OK], [p=l-1=Description:, {p=l-1=If there is an ongoing transaction (i.e. the DMA channel is active) the function waits for the transaction to be finished. If the previously programmed channel setup is not completely finished the function performs a channel reset and sets the bit RBA_DMA_SETUPCH_CHNOTREADY_ERR_POS in *stErr_cpu32. Afterwards the new channel settings are programmed normally and the function will return E_OK., p=l-1=Following conditions will prevent the function from programming a DMA channel, list=[p=l-1=resolving of channel ID fails, bit RBA_DMA_SETUPCH_ID_ERR_POS is set in *stErr_cpu32, p=l-1=resolved channel or move engine numbers are out of range, bit RBA_DMA_SETUPCH_RSLV_ERR_POS is set in *stErr_cpu32. This normally happens in post-build environments when the channel is not configured in the currently active post build variant, p=l-1=function parameter swtSize_u8 is out of range, bit RBA_DMA_SETUPCH_SWTSIZE_ERR_POS is set in *stErr_cpu32, p=l-1=function parameter swtChTrig_u8 is out of range, bit RBA_DMA_SETUPCH_SWTCHTRIG_ERR_POS is set in *stErr_cpu32, p=l-1=function parameter numMoves_u32 is out of range, bit RBA_DMA_SETUPCH_NUMMOVES_ERR_POS is set in *stErr_cpu32, p=l-1=if a channel link trigger is selected in adrConfig_cpcst but the link target has not been configured in arxml configuration the bit RBA_DMA_SETUPCH_LINKCH_ERR_POS is set., p=l-1=if the parameter numTrig_u32 is too large the bit RBA_DMA_SETUPCH_NUMTRIG_ERR_POS is set *stErr_cpu32, p=l-1=If RBA_DMA_SETUPCH_SRCBUFSIZE_ERR_POS and/or RBA_DMA_SETUPCH_DESTBUFSIZE_ERR_POS is set then the circular buffer sizes are not correct. (must be a power of 2 each)], p=l-1=In all of the listed cases the function will return E_NOT_OK and won't do a DMA channel configuration.}]]:
                        table caption ID95432223488672  # rba_Dma_SetUpCh
                      table tgroup=tbody=[[p=l-1=ENBL_HW_TRG, p=l-1=IMDT_TRG, p=l-1=TRG_LINK_INNER, p=l-1=TRG_LINK_OUTER, p=l-1=LINK_TARGET, p=l-1=KEEP_HWTRIGGER, p=l-1=ENA_RING_BUF], [p=l-1=ENBL_HW_TRG, p=l-1=na, p=l-1=+, p=l-1=+, p=l-1=+, p=l-1=+(1), p=l-1=+, p=l-1=+], [p=l-1=IMDT_TRG, p=l-1=+, p=l-1=na, p=l-1=+, p=l-1=+, p=l-1=-, p=l-1=+(3), p=l-1=+], [p=l-1=TRG_LINK_INNER, p=l-1=+, p=l-1=+, p=l-1=na, p=l-1=+, p=l-1=-, p=l-1=+(3), p=l-1=+], [p=l-1=TRG_LINK_OUTER, p=l-1=+, p=l-1=+, p=l-1=+, p=l-1=na, p=l-1=-, p=l-1=+(3), p=l-1=-(4)], [p=l-1=LINK_TARGET, p=l-1=+(1), p=l-1=-, p=l-1=-, p=l-1=-, p=l-1=na, p=l-1=+(3), p=l-1=+], [p=l-1=KEEP_HWTRIGGER, p=l-1=+, p=l-1=+(3), p=l-1=+(3), p=l-1=+(3), p=l-1=+(3), p=l-1=na, p=l-1=+(2)], [p=l-1=ENA_RING_BUF, p=l-1=+, p=l-1=+, p=l-1=+, p=l-1=-(4), p=l-1=+, p=l-1=+(2), p=l-1=na]]:
                        table caption ID03266540208202  # swtChTrig_u8 bit combinations
                    rba_Dma_GetDstAdr
                      table tgroup=tbody=[[p=l-1=Service name:, p=l-1=rba_Dma_GetDstAdr], [p=l-1=Syntax:, verbatim=l-5=Std_ReturnType rba_Dma_GetDstAdr(rba_Dma_Id_ten const idChan_cen, uint32* const adrDst_cpu32)], [p=l-1=Service ID [hex]:, p=l-1=na], [p=l-1=Sync/Async:, p=l-1=Synchronous], [p=l-1=Reentrancy:, p=l-1=Reentrant], [p=l-1=Parameters (in):, p=l-1=idChan_cen: channel identifier, must be of type rba_Dma_Id_ten.], [p=l-1=Parameters (inout):, p=l-1=-], [p=l-1=Parameters (out):, p=l-1=adrDst_cpu32: pointer to storage of the returned destination address, must be a pointer to uint32.], [p=l-1=Return value:, p=l-1=Std_ReturnType: Returns E_OK if the resolving was successful, else E_NOT_OK], [p=l-1=Description:, p=l-1=This function returns the current vale of the given channel's destination address register]]:
                        table caption ID29065446092799  # rba_Dma_GetDstAdr
                    rba_Dma_Init
                      table tgroup=tbody=[[p=l-1=Service name:, p=l-1=rba_Dma_Init], [p=l-1=Syntax:, verbatim=l-5=void rba_Dma_Init (rba_Dma_ConfigType const * const argPbVar_cpc)], [p=l-1=Service ID [hex]:, p=l-1=na], [p=l-1=Sync/Async:, p=l-1=Synchronous], [p=l-1=Reentrancy:, p=l-1=Non Reentrant], [p=l-1=Parameters (in):, p=l-1=argPbVar_cpc: Pointer to the selected post build configuration variant.], [p=l-1=Parameters (inout):, p=l-1=-], [p=l-1=Parameters (out):, p=l-1=-], [p=l-1=Return value:, p=l-1=-], [p=l-1=Description:, p=l-1=This function initialises the DMA hardware module.]]:
                        table caption ID07766784448949  # rba_Dma_Init
                    rba_Dma_Shutdown:
                      p=l-1=Following actions are done for IFX controllers
                      list=[p=l-1=Clear error interrupt registers DMA_ERR0 and DMA_ERR1, {p=l-1=Loop through all configured DMA channels, list=[p=l-1=disable HW request line for each channel (using the DCH bit), p=l-1=Wait until the Bit CH is reset by DMA module (if it was set at all)]}, p=l-1=Reset all DMA_ACCENx0 registers]
                      p=l-1=Following actions are done for JDP controllers
                      list=[{p=l-1=For each move engine:, list=[p=l-1=Set CR.HALT to reject all incoming HW triggers., p=l-1=Disable all HW triggers: clear ERQL(ERQH) register, p=l-1=Clear all interrupt requests: Set INTL(INTH) = 0xFFFFFFFF, p=l-1=Disable all error interrupts,: Set EEIL(EEIH) = 0x0]}, {p=l-1=Loop through all configured DMA channels,, list=item=p=l-1=Wait until the active bit (TCD_CSR.ACTIVE) is cleared}]
                      table tgroup=tbody=[[p=l-1=Service name:, p=l-1=rba_Dma_Shutdown], [p=l-1=Syntax:, verbatim=l-5=void rba_Dma_Shutdown (void)], [p=l-1=Service ID [hex]:, p=l-1=na], [p=l-1=Sync/Async:, p=l-1=Synchronous], [p=l-1=Reentrancy:, p=l-1=Non Reentrant], [p=l-1=Parameters (in):, p=l-1=-], [p=l-1=Parameters (inout):, p=l-1=-], [p=l-1=Parameters (out):, p=l-1=-], [p=l-1=Return value:, p=l-1=-], [p=l-1=Description:, p=l-1=This function prevents further triggering of DMA channels, currently ongoing transfers are allowed to finish. DMA error interrupts are disabled, DMA hardware trigger inputs are disabled.]]:
                        table caption ID93387348358728  # rba_Dma_Shutdown
                    rba_Dma_Error_Isr: list=[{p=l-1=rba_Reset user specific data for IFX controllers, the lower 16 bit are taken from the move engine 0 error register, the upper 16 bit are taken from move engine 1 error register., verbatim=l-5=// layout of dataUserDefined_u32 which is passed to rba_Reset_Request() // it contains all bitfields of the two ERRSE0/1 registers // // 31 30 29 28 27 26 25 24 23 22 21 20 19 18 17 16|15 14 13 12 11 10 9 8 7 6 5 4 3 2 1 0 // ------------------------------------------------|----------------------------------------------- // 0 D S R S S D S 0|------ LEC1 --------| 0 D S R S S D S 0 |------ LEC0 -------| // L L A R P E E | L L A R P E E // L L M I B R R | L L M I B R R // E E E E E 1 1 | E E E E E 0 0 // R R R R R | R R R R R // 1 1 1 1 1 | 0 0 0 0 0}, {p=l-1=rba_Reset user specific data for JDP controllers, the lower 16 bit are taken from the move engine 0 error register, the upper 16 bit are taken from move engine 1 error register. the bits 8, 9, 24 and 25 are packed (ored) bits which are calculated as described., verbatim=l-5=// layout of dataUserDefined_u32 which is passed to rba_Reset_Request() // it contains all bitfields of the two ERRSE0/1 registers // // 31 30 29 28 27 26 25 24 23 22 21 20 19 18 17 16|15 14 13 12 11 10 9 8 7 6 5 4 3 2 1 0 // ------------------------------------------------|------------------------------------------------ // U E G C N S D S 0 0 |---- ERRCHN1 ---| U E G C N S D S 0 0 |---- ERRCHN0 ---| // C C P P C G E E | C C P P C G E E // E X E E E E R R | E X E E E E R R // 1 1 1 1 1 1 R R | 0 0 0 0 0 0 R R // 1 1 | 0 0 // // with SERRx = SAEx | SOEx | SBEx // and DERRx = DAEx | DOEx | DBEx}]
                      table tgroup=tbody=[[p=l-1=Service name:, p=l-1=rba_Dma_Error_Isr], [p=l-1=Syntax:, verbatim=l-5=void rba_Dma_Error_Isr (void)], [p=l-1=Service ID [hex]:, p=l-1=na], [p=l-1=Sync/Async:, p=l-1=Synchronous], [p=l-1=Reentrancy:, p=l-1=Non Reentrant], [p=l-1=Parameters (in):, p=l-1=-], [p=l-1=Parameters (inout):, p=l-1=-], [p=l-1=Parameters (out):, p=l-1=-], [p=l-1=Return value:, p=l-1=-], [p=l-1=Description:, {p=l-1=This process shall be scheduled whenever a DMA HW error interrupt is triggered. It does two different things depending on the configured error reaction (configuration item rba_Dma_ErrReaction):, list=[p=l-1=None: No interrupt is triggered, this process is not scheduled, p=l-1=Count/Det: The counter variable rba_Dma_cntrErrIsr_u32 is incremented by one and - if Det report is enabled - a Det entry is dispatched. The Det 'ErrorId' contains the DMA channel number causing the error., p=l-1=Reset: In case of a DMA HW error a reset is triggered using the function rba_ResetRequest(). The rba_Reset 'user data' is controller-specific and is described below. The counter rba_Dma_cntrErrIsr_u32 is also incremented by one.]}]]:
                        table caption ID81076551426966  # rba_Dma_Error_Isr
                    RBA_DMA_SET_ADR: verbatim=l-5=// example: { uint8 numDmaUnit2_u8; uint8 numDmaChan2_u8; uint32 xDmaSource_au32[16]; uint32 xDmaTarget_au32[16]; if (rba_Dma_GetIdx(rba_Dma_DmaTestChan2, &numDmaUnit2_u8, &numDmaChan2_u8) != E_NOT_OK) { // write new addresses RBA_DMA_SET_ADR(numDmaUnit2_u8, numDmaChan2_u8, &xDmaSource_u32[0], &xDmaTarget_avu16[0]) } }
                      table tgroup=tbody=[[p=l-1=Service name:, p=l-1=RBA_DMA_SET_ADR], [p=l-1=Syntax:, verbatim=l-5=e=RBA_DMA_SET_ADR], [p=l-1=Service ID [hex]:, p=l-1=na], [p=l-1=Sync/Async:, p=l-1=Synchronous], [p=l-1=Reentrancy:, p=l-1=Reentrant], [p=l-1=Parameters (in):, [l-1=idxUnit_u8: DMA unit/module number, l-1=idxCh_u8: DMA channel number, l-1=adrSrc_cpcv: source address, l-1=adrDest_cpcv: destination address]], [p=l-1=Parameters (inout):, p=l-1=-], [p=l-1=Parameters (out):, p=l-1=-], [p=l-1=Return value:, p=l-1=-], [p=l-1=Description:, p=l-1=This function-like macro initialises the source and destination registers of the specified DMA channel with the given addresses. If either source or destination address is given as 'NULL_PTR' the appropriate register is not changed.]]:
                        table caption ID07766784448950  # RBA_DMA_SET_ADR
                BswDocInterfaceCOutgoingCallbacks  # Outgoing callbacks
                BswDocInterfaceCMacros:  # Macros
                  p=l-1=Following macros are defined depending on machine type
                  verbatim=l-5=// number of logical DMA move engines #define RBA_DMA_NUM_DMA_MODULES 2 // number of DMA channels per move engine (if move engines have different channels the highest is listed) #define RBA_DMA_NUM_DMA_CHANS 24
                  p=l-1=Following macros are defined to be used with the services 'rba_Dma_GetChSts' and 'rba_Dma_SetUpCh'
                  note=p=l-1=Don't rely on the shown numbers, they might change without further announcement
                  verbatim=l-5=#define RBA_DMA_GETCHSTS_ID_ERR_POS 0ul #define RBA_DMA_GETCHSTS_RSLV_ERR_POS 1ul #define RBA_DMA_GETCHSTS_CHACTV_ERR_POS 4ul #define RBA_DMA_GETCHSTS_REQLOST_ERR_POS 8ul #define RBA_DMA_GETCHSTS_SER_ERR_POS 16ul #define RBA_DMA_GETCHSTS_DER_ERR_POS 17ul #define RBA_DMA_GETCHSTS_FPIER_ERR_POS 20ul #define RBA_DMA_GETCHSTS_SRIER_ERR_POS 21ul #define RBA_DMA_GETCHSTS_PERER_ERR_POS 22ul #define RBA_DMA_SETUPCH_ID_ERR_POS 0ul #define RBA_DMA_SETUPCH_RSLV_ERR_POS 1ul #define RBA_DMA_SETUPCH_SWTSIZE_ERR_POS 2ul #define RBA_DMA_SETUPCH_SWTCHTRIG_ERR_POS 3ul #define RBA_DMA_SETUPCH_NUMMOVES_ERR_POS 4ul #define RBA_DMA_SETUPCH_LINKCH_ERR_POS 5ul #define RBA_DMA_SETUPCH_NUMTRIG_ERR_POS 6ul #define RBA_DMA_SETUPCH_CHNOTREADY_ERR_POS 16ul #define RBA_DMA_SETUPCH_SRCBUFSIZE_ERR_POS 17ul #define RBA_DMA_SETUPCH_DESTBUFSIZE_ERR_POS 18ul
                  table tgroup={thead=row=[p=l-1=Macro, p=l-1=Function], tbody=[[[l-1=RBA_DMA_SETUPCH_ENBL_HW_TRG_POS, l-1=RBA_DMA_SETUPCH_ENBL_HW_TRG_MSK], p=l-1=Enables the hardware trigger of the selected DMA channel. The HW trigger is automatically disabled after the selected number of triggers (numTrig_u32) occurred.], [[l-1=RBA_DMA_SETUPCH_IMDT_TRG_POS, l-1=RBA_DMA_SETUPCH_IMDT_TRG_MSK], p=l-1=Triggers the selected channel one time immediately after the setup.], [[l-1=RBA_DMA_SETUPCH_TRG_LINK_INNER_POS, l-1=RBA_DMA_SETUPCH_TRG_LINK_INNER_MSK], p=l-1=If this bit is set the channel is set up to trigger another channel after each incoming trigger event.], [[l-1=RBA_DMA_SETUPCH_TRG_LINK_OUTER_POS, l-1=RBA_DMA_SETUPCH_TRG_LINK_OUTER_MSK], p=l-1=If this bit is set the channel is set up to trigger another channel after the selected number of triggers (numTrig_u32) occurred.], [[l-1=RBA_DMA_SETUPCH_LINK_TARGET_POS, l-1=RBA_DMA_SETUPCH_LINK_TARGET_MSK], p=l-1=If this bit is set the channel is configured as the link target in a linked channel configuration.], [[l-1=RBA_DMA_SETUPCH_KEEP_HWTRIGGER_POS, l-1=RBA_DMA_SETUPCH_KEEP_HWTRIGGER_MSK], p=l-1=If this bit is set the HW trigger input is not disabled after completion of all configured trigger events (numTrig_u32)], [[l-1=RBA_DMA_SETUPCH_ENA_RING_BUF_POS, l-1=RBA_DMA_SETUPCH_ENA_RING_BUF_MSK], [l-1=Enables ring (or circular) buffer set up of the DMA channel. If this bit is set the two parameters numSrcBuf_u32 and numDestBuf_u32 are also evaluated and must be filled configured with source and destination size of the circular buffers., l-1=Hint: if this bit is set and ENA_OPTIONS2 is also set the ring buffer mode for source and destination is activated regardless the setting of the two bits ENA_RING_BUFF_SRC and ENA_RING_BUFF_DST]], [[l-1=RBA_DMA_SETUPCH_ENA_OPTIONS2_POS, l-1=RBA_DMA_SETUPCH_ENA_OPTIONS2_MSK], p=l-1=Enables the evaluation of the second transfer option parameter swtOptions2_u32. If this bit is not set swtOptions2_u32 is not considered at all.]]}:
                    table caption ID21072285948023  # Bit field definitions for parameter swtChTrig_u8
                  table tgroup={thead=row=[p=l-1=Macro, p=l-1=Function], tbody=[[[l-1=RBA_DMA_SETUPCH_ENA_RING_BUFF_SRC_POS, l-1=RBA_DMA_SETUPCH_ENA_RING_BUFF_SRC_MSK], p=l-1=Enables ring buffer mode for source transaction], [[l-1=RBA_DMA_SETUPCH_ENA_RING_BUFF_DST_POS, l-1=RBA_DMA_SETUPCH_ENA_RING_BUFF_DST_MSK], p=l-1=Enables ring buffer mode for destination transaction], [[l-1=RBA_DMA_SETUPCH_DECREMENT_SRC_POS, l-1=RBA_DMA_SETUPCH_DECREMENT_SRC_MSK], p=l-1=If this bit is set the source address is decremented, if it is cleared the address is incremented (default behaviour)], [[l-1=RBA_DMA_SETUPCH_DECREMENT_DST_POS, l-1=RBA_DMA_SETUPCH_DECREMENT_DST_MSK], p=l-1=If this bit is set the destination address is decremented, if it is cleared the address is incremented (default behaviour)], [[l-1=RBA_DMA_SETUPCH_SRC_OFFSET_POS, l-1=RBA_DMA_SETUPCH_SRC_OFFSET_MSK], p=l-1=This bit field and the data width determine an address offset value by which the source address is modified after each DMA move], [[l-1=RBA_DMA_SETUPCH_DST_OFFSET_POS, l-1=RBA_DMA_SETUPCH_DST_OFFSET_MSK], p=l-1=This bit field and the data width determine an address offset value by which the destination address is modified after each DMA move]]}:
                    table caption ID21072285948024  # Bit field definitions for parameter swtOptions2_u32
                BswDocInterfaceCPreproc: p=l-1=For each configured DMA channel there is a macro definition to allow (de-)activation of code blocks depending on existence of this channel configuration. This macro is generated if a channel is configured in at least one post build variant. The macro is derived from the configured signal name, for example:  # Preprocessor constants
                  table tgroup={thead=row=[p=l-1=Configured channel name, p=l-1=rba_Dma signal identifier, p=l-1=Generated macro name], tbody=[[p=l-1=AdcDs_Value_0, p=l-1=rba_Dma_AdcDs_Value_0, p=l-1=RBA_DMA_ADCDS_VALUE_0_CONF], [p=l-1=rba_Msc_HwUnit0_Us, p=l-1=rba_Dma_rba_Msc_HwUnit0_Us, p=l-1=RBA_DMA_RBA_MSC_HWUNIT0_US_CONF], [p=l-1=rba_SpiIfx_HwUnit0_Tx1, p=l-1=rba_Dma_rba_SpiIfx_HwUnit0_Tx1, p=l-1=RBA_DMA_RBA_SPIIFX_HWUNIT0_TX1_CONF]]}:
                    table caption ID21072285948022  # Preprocessor constants
                BswDocInterfaceCDataTypes  # Data types
                  chapter ID75945865043811: p=l-1=The resulting generated enumeration looks like:, verbatim=l-5=typedef enum { rba_Dma_AdcDs_Gtm_2, rba_Dma_AdcDs_Value_0, rba_Dma_AdcDs_Value_2, rba_Dma_rba_AdcIfx_Mux0, rba_Dma_rba_AdcIfx_Mux1, rba_Dma_rba_AdcIfx_Mux2, rba_Dma_rba_AdcIfx_Mux3, rba_Dma_rba_Msc_HwUnit0_Us, rba_Dma_rba_Msc_HwUnit1_Us, rba_Dma_rba_SpiIfx_HwUnit0_Rx, rba_Dma_rba_SpiIfx_HwUnit0_Tx1, rba_Dma_rba_SpiIfx_HwUnit0_Tx2, RBA_DMA_NUM_IDS_E } rba_Dma_Id_ten;  # rba_Dma_Id_ten
                    table tgroup=tbody=[[p=l-1=Name:, p=l-1=rba_Dma_Id_ten], [p=l-1=Type:, p=l-1=Enumeration], [p=l-1=Range:, {p=l-1=List of all configured DMA channels across all post build variants. Contents are configuration dependent. Only two entries are listed as example:, list=[p=l-1=rba_Dma_AdcDs_Value_0: derived from short name 'AdcDs_Value_0', p=l-1=rba_Dma_rba_Msc_HwUnit1_Us: derived from short name 'rba_Msc_HwUnit1_Us', p=l-1=RBA_DMA_NUM_PB_VRNT_E: Last element.]}], [p=l-1=Description:, p=l-1=This enumeration is a list of all configured DMA channels, it contains each short name of the entire DMA configuration. Last enum in the list is always RBA_DMA_NUM_IDS_E. See example for details. rba_Dma_Id_ten is used as parameter for the interface rba_Dma_GetIdx().]]:
                      table caption ID04526344146667  # rba_Dma_Id_ten
                  chapter rba_Dma_SetUpCh_tst
                    table tgroup=tbody=[[p=l-1=Name:, p=l-1=rba_Dma_SetUpCh_tst], [p=l-1=Type:, p=l-1=Structure], [p=l-1=Element:, p=l-1=void*, p=l-1=adrSrc_pv, p=l-1=source address pointer, may point to uint8, uint16 or uint32], [p=l-1=void*, p=l-1=adrDest_pv, p=l-1=destination address pointer, may point to uint8, uint16 or uint32], [p=l-1=uint32, p=l-1=numTrig_u32, p=l-1=number of triggers, outer loop counter, how many SW or HW triggers shall be processed until DMA sequence ends], [p=l-1=uint32, p=l-1=numMoves_u32, p=l-1=number of data moves per trigger, number is DMA HW dependent! To be HW-independent, restrict to 1, 2, 3, 4, 5, 8, 9 or 16 moves per trigger. Other values are possible but will lead to an error if the HW does not support this configuration. A value of '0' is not allowed.], [p=l-1=uint8, p=l-1=swtSize_u8, {p=l-1=data transfer size, valid values are, list=[p=l-1=0: uint8, p=l-1=1: uint16, p=l-1=2: uint32]}], [p=l-1=boolean, p=l-1=swtIncSrc_b, {p=l-1=increment source address, valid values are:, list=[p=l-1=TRUE: source address is incremented based on transfer size, p=l-1=FALSE:source address is not incremented]}], [p=l-1=boolean, p=l-1=swtIncDest_b, {p=l-1=increment destination address, valid values are:, list=[p=l-1=TRUE: source address is incremented based on transfer size, p=l-1=FALSE:source address is not incremented]}], [p=l-1=boolean, p=l-1=swtEnaReq_b, {p=l-1=enable service request trigger after end of outer loop, valid values are:, list=[p=l-1=TRUE: source address is incremented based on transfer size, p=l-1=FALSE:source address is not incremented]}], [p=l-1=uint8, p=l-1=swtChTrig_u8, {p=l-1=various trigger actions, setting following bits will do:, list=[p=l-1=RBA_DMA_SETUPCH_NO_TRG: do nothing (HW trigger is disabled), p=l-1=RBA_DMA_SETUPCH_ENBL_HW_TRG_POS: enable HW trigger for DMA channel, p=l-1=RBA_DMA_SETUPCH_IMDT_TRG_POS: do a SW trigger after channel initialisation (HW trigger is disabled), p=l-1=RBA_DMA_SETUPCH_TRG_LINK_INNER_POS: after completion of each inner loop the configured target DMA channel is triggered once, also after the last inner loop., p=l-1=RBA_DMA_SETUPCH_TRG_LINK_OUTER_POS: after completion of the last inner loop the configured target DMA channel is triggered once, p=l-1=RBA_DMA_SETUPCH_LINK_TARGET_POS: this flag must be set if the channel shall act as a salve channel in a channel-linking configuration, p=l-1=RBA_DMA_SETUPCH_KEEP_HWTRIGGER_POS: keep HW trigger enabled after completion of the major loop, p=l-1=RBA_DMA_SETUPCH_ENA_RING_BUF_POS: activate circular/ring buffer configuration, p=l-1=RBA_DMA_SETUPCH_ENA_OPTIONS2_POS: enables the evaluation of swtOptions2_u32], note=p=l-1=A channel-linking set-up needs additional configuration in the master channel!}], [p=l-1=uint16, p=l-1=numSrcBuf_u16, p=l-1=source buffer size in circular buffer configuration (only necessary if bit ENA_RING_BUF is set in swtChTrig_u8)], [p=l-1=uint16, p=l-1=numDestBuf_u16, p=l-1=destination buffer size in circular buffer configuration (only necessary if bit ENA_RING_BUF is set in swtChTrig_u8)], [p=l-1=uint32, p=l-1=swtOptions2_u32, {p=l-1=additional transfer options. Evaluation of swtOptions2_u32 must be enabled in swtChTrig_u8. Following options are available:, list=[p=l-1=RBA_DMA_SETUPCH_ENA_RING_BUFF_SRC_POS: enable circular/ring buffer mode for source, p=l-1=RBA_DMA_SETUPCH_ENA_RING_BUFF_DST_POS: enable circular/ring buffer mode for destination, p=l-1=RBA_DMA_SETUPCH_DECREMENT_SRC_POS: decrement source address (if swtIncSrc_b == TRUE), p=l-1=RBA_DMA_SETUPCH_DECREMENT_DST_POS: decrement destination address (if swtIncDest_b == TRUE)., p=l-1=RBA_DMA_SETUPCH_SRC_OFFSET_POS: Address offset value by which the source address will be modified. Refer Table 30 to check the possible address offset values., p=l-1=RBA_DMA_SETUPCH_DST_OFFSET_POS: Address offset value by which the destination address will be modified.Refer Table 30 to check the possible address offset values.]}], [p=l-1=Description:, p=l-1=This is the configuration structure for the service rba_Dma_SetUpCh()]]:
                      table caption ID20539031894129  # rba_Dma_SetUpCh_tst
                    table tgroup=tbody=[[p=l-1=e=SRC_OFFSET / DST_OFFSET, p=l-1=e=Address Offset], [p=l-1=000, p=l-1=1 x Data width], [p=l-1=001, p=l-1=2 x Data width], [p=l-1=010, p=l-1=4 x Data width], [p=l-1=011, p=l-1=8 x Data width], [p=l-1=100, p=l-1=16 x Data width], [p=l-1=101, p=l-1=32 x Data width], [p=l-1=110, p=l-1=64 x Data width], [p=l-1=111, p=l-1=128 x Data width]]:
                      table caption Possible_Address_Offset_Values  # Address Offset Calculation Table
                  chapter ID01853531799098  # rba_Dma_ConfigType
                    table tgroup=tbody=[[p=l-1=Name:, p=l-1=rba_Dma_ConfigType], [p=l-1=Type:, p=l-1=Enumeration], [p=l-1=Range:, {p=l-1=Lists all configured post build variants. Contents are configuration dependent., list=[p=l-1=rba_Dma_Config_4Cyl_E: First post build variant '4Cyl', p=l-1=rba_Dma_Config_6Cyl_E: Second post build variant '6Cyl', p=l-1=RBA_DMA_NUM_PB_VRNT_E: Last element.]}], [p=l-1=Description:, p=l-1=This type contains a list of all post build variants. Last enum in the list is always RBA_DMA_NUM_PB_VRNT_E.]]:
                      table caption ID73968588437287  # rba_Dma_ConfigType
                BswDocInterfaceCConstants  # Constants
                BswDocInterfaceCVariables  # Variables
            BswDocInterfaceSched  # Scheduling interface
        BswDocEnvNeeds  # Environment needs
          5 x chapter:
            BswDocEnvNeedsDemEvents: p=l-1=rba_Dma does not create any Dem event.  # Dem events
            BswDocEnvNeedsDetEvents: p=l-1=two functions may dispatch a Det entry:, list=[[l-1=RBA_DMA_PRV_APIID_INIT (value 0): rba_Dma_Init(), l-1=ErrorId in this case is always RBA_DMA_PRV_ERRID_PENDING_ERR which means that there was a pending error interrupt which is cleared during rba_Dma_Init().], [l-1=RBA_DMA_PRV_APIID_ERR_ISR (value 1): rba_Dma_Error_Isr(), l-1=The ErrorId in this case is described along with the description of the process rba_Dma_Error_Isr().]]  # Det events
            BswDocEnvNeedsNvBlocks: p=l-1=rba_Dma does not require NvM blocks.  # Non-volatile memory blocks
            BswDocEnvNeedsExclAreas  # Exclusive areas
            BswDocEnvNeedsMemMap: p=l-1=File rba_Dma_MemMap.h is available for memory mapping of rba_Dma.  # Memory mapping
        BswDocDependencies  # Dependencies
          4 x chapter:
            BswDocDependenciesCompPac: p=l-1=rba_Dma requires following packages:, list=[p=l-1=Mcu, p=l-1=rba_Reg]  # Other components/packages
            BswDocDependenciesSw: p=l-1=See package documentation.  # Software environment
            BswDocDependenciesHw: p=l-1=Following devices are supported:, list=[p=l-1=IFX Dev2 B-step, p=l-1=IFX Dev3 C-step, p=l-1=IFX Dev3 D-step, p=l-1=IFX Dev4 B-step, p=l-1=JDP Dev2 2nd silicon, p=l-1=JDP Dev3 2nd silicon, p=l-1=JDP Dev4 2nd silicon, p=l-1=ST Dev3+ 1st silicon]  # Hardware environment
            BswDocDependenciesTools: p=l-1=See package documentation.  # Tool environment
        BswDocVariants  # Variant handling
          chapter BswDocVariantsSysConst  # System constants
          chapter BswDocVariantsFileSelection  # File selection
          chapter BswDocVariantsTemplCust: p=l-1=Not supported.  # Template customization
        BswDocIntegration  # Integration
          4 x chapter:
            BswDocIntegrationEffort  # Estimated effort
            BswDocIntegrationHowTo: list=[{note=p=l-1=e=Interface change in rba_Dma P_AR40.0.7.0, p=l-1=Following interfaces were changed and need to be checked if they are in use:, verbatim=l-5=Std_ReturnType rba_Dma_GetIdx (rba_Dma_Id_ten const idChan_cen, uint8_least* const ptrUnitVal_cpqu8, uint8_least* const ptrChVal_cpqu8), verbatim=l-5=Std_ReturnType rba_Dma_GetUnitNr (rba_Dma_Id_ten const idChan_cen, uint8_least* const ptrIdxVal_cpqu8), verbatim=l-5=Std_ReturnType rba_Dma_GetChNr (rba_Dma_Id_ten const idChan_cen, uint8_least* const ptrIdxVal_cpqu8), p=l-1=New interface prototypes:, verbatim=l-5=Std_ReturnType rba_Dma_GetIdx (rba_Dma_Id_ten const idChan_cen, uint8* const ptrUnitVal_cpqu8, uint8* const ptrChVal_cpqu8), verbatim=l-5=Std_ReturnType rba_Dma_GetUnitNr (rba_Dma_Id_ten const idChan_cen, uint8* const ptrIdxVal_cpqu8), verbatim=l-5=Std_ReturnType rba_Dma_GetChNr (rba_Dma_Id_ten const idChan_cen, uint8* const ptrIdxVal_cpqu8), p=l-1=Dma users are informed and will provide adapted component versions. Of course, Mcal internal components using these interfaces are already adapted. If these interfaces are used in any other components (like injection, ignition complex drivers) and there are no newer versions with adapted interfaces available, then there is need for manual adaption in these components. Don't hesitate to contact Andreas GeÃŸ (CDG-SMT/ESA1) for assistance.}, {p=l-1=General hints: What needs to be done in rba_Dma configuration:, list=[p=l-1=Each Dma user needs to have his own DMA channel allocated, so the integrator needs to specify a DMA channel for each DMA user. This is done by configuration of the tags 'Unit' and 'Channel' referencing the short name of the DMA user., p=l-1=For projects using JDP Dev4: Before allocating a DMA channel to move engine 1 please be sure that the corresponding component supports this configuration (see integration hints there). If that is unclear allocate the channel to DMA move engine 0 which is supported in any case.]}]  # How to integrate
            BswDocIntegrationSched: p=l-1=All init-processes of components using DMA resources must be placed after rba_Dma_Init().  # Scheduling aspects
            BswDocIntegrationBuild: p=l-1=See package documentation.  # Build aspects
        BswDocUseCases  # Use cases
        BswDocMisc  # Miscellaneous

AUTOSAR XML (schema 4-2-2)
package /RB/RBA/rba_Dma/BswImplementations
  bsw implementation rba_Dma: programming-language=C, sw-version=4.34.0, ar-release-version=4.2.2, behavior=BswInternalBehavior, vendor-specific-module-def=rba_Dma
    code-descriptors:
      code CodeDescriptor: artifact-descriptors=autosar-engineering-object={short-label=ArEngObj, category=SWSRC}
package /RB/RBA/rba_Dma/BswModuleDescriptions
  bsw module description rba_Dma: category=BSW_MODULE, module-id=254, provided-entrys=rba_Dma_Init
    bsw internal behavior BswInternalBehavior
      bsw called entity rba_Dma_Init: implemented-entry=rba_Dma_Init
package /RB/RBA/rba_Dma/BswModuleEntrys
  bsw module entry rba_Dma_Init: service-id=0, is-reentrant=false, is-synchronous=true, call-type=REGULAR, execution-context=UNSPECIFIED, sw-service-impl-policy=STANDARD  # DMA initialization
    sw service arg rba_Dma_ConfigType: direction=IN, implementation-data-type=rba_Dma_ConfigType
package /RB/RBA/rba_Dma/ImplementationDataTypes
  impl type rba_Dma_ConfigType: implementation-data-type=uint8, type-emitter=rba_Dma

AUTOSAR XML (schema 4-2-2)
package /RB/RBA/rba_I2c/EcucModuleDefs
  module definition rba_I2c [0..1]: category=VENDOR_SPECIFIC_MODULE_DEFINITION, post-build-variant-support=true, refined-module-def=rba_I2C, variants pre-compile  # MCAL Inter_Integrated_Circuit | Configuration of the I2C (Inter-Integrated Circuit) module in MCAL layer.
    container rba_I2c_ConfigSet  # Configuration data set | This is the base container that contains the post-build selectable configuration parameters.
      container rba_I2c_IfxHwUnit [0..*]: multiplicity set at pre-compile, post-build-variant-multiplicity=true  # IFX Hw unit config | IFX hardware uint container Configuration is not Mandatory . This container configuration is only for the IFX controller. This container select the (IFX) I2C- port multiplexer selection HW-Unit specific parameters. Software supporting channels I2C0 and I2C1 channels. configure the I2C channel depend the I2C-hardware usage (availability) in the ECU. If IFX HW configuration is not present softare will consider the Default setting as I2C port Multiplexer as -'A';
        enumeration rba_I2c_HwModule: {I2C_0, I2C_1}, origin=RB:v0.1.0:2013-02-20, post-build-variant-value=true, set at pre-compile, default-value=I2C_0  # IFX I2C Hw module | Hardware Module Configuration is Mandatory for the rba_I2c_IfxHwUnit container. I2C- Hardware module selection.( Mandatory parameter ) IFX-hardware Hint: 1.(DEV2,DEV3 have the one I2C channel- I2C0) 2.(DEV4, DEV5 have the Two I2C channel- I2C0 and I2C1)
        enumeration rba_I2c_PortSelect: origin=RB:0.1.0:2013-02-20, post-build-variant-value=true, set at pre-compile, default-value=PORTSELECT_A  # IFX Port pin selection (I2C Mux) | Port selection Configuration is for the rba_I2c_IfxHwUnit container. I2C interface PORT pin Multiplexer Selection of the input pins providing the serial data and clock input signals. Not all enumeration PORT options are available for the all controller See the Ports chapter. For the I2C-port selection refer the HW schematic and find the I2C interface port pin. IFX- device user Manuel check the I2C-port pin related the Multiplexer. IFX-Available Multiplexer info(This port info not common for all device variant): Configuration allowed: PORTSELECT_A: PORTSELECT_B PORTSELECT_C PORTSELECT_D PORTSELECT_E PORTSELECT_F PORTSELECT_G PORTSELECT_H
          PORTSELECT_A  # PortSelect_A
          PORTSELECT_B  # PortSelect_B
          PORTSELECT_C  # PortSelect_C
          PORTSELECT_D  # PortSelect_D
          PORTSELECT_E  # PortSelect_E
          PORTSELECT_F  # PortSelect_F
          PORTSELECT_G  # PortSelect_G
          PORTSELECT_H  # PortSelect_H
      container rba_I2c_SlaveConfig [1..*]: multiplicity set at pre-compile, post-build-variant-multiplicity=true  # Slave config | Slave Configuration container configuration is Mandatory in I2C configuration set. I2C interface each slave device for one configuration container. Slave Id name is specified by the containers short name. ( Mandatory Container )-If configuration is not present (least one slave required) I2C interface will be disable. Configuration hint: short name like rba_I2c_SlaveConfig_xxx Value: Depend the hardware container create the multiple container. Short name as like hardware number Ex for sequence rba_I2c_SequenceConfig_PortExp
        string rba_I2c_SlaveAddress: origin=RB:0.1.0:2013-01-08, post-build-variant-value=true, set at pre-compile  # Slave address (hex format) | Slave address parameter Configuration is Mandatory for the rba_I2c_SlaveConfig container. I2C Slave (1-7)7bit Unique ID in hex decimal format. This ID has provided by the I2C-slave hardware manufacture. 0th bit Read/Write must be Zero ( Mandatory parameter ) Configuration allowed: Min value 0x00 Max value 0xFE Value: Ex: 0xA0
        enumeration rba_I2c_SlaveConnModule: {I2C_0, I2C_1}, origin=RB:v0.1.0:2013-02-20, post-build-variant-value=true, set at pre-compile, default-value=I2C_0  # Slave connect to I2C module | Slave connection module parameter configuration dataset is a Mandatory for the rba_I2c_SlaveConfig container.. Select the slave interface to I2C hardware module(I2C0 or I2C1). Configuration allowed: I2C_0 I2C_1 Default_Selection: I2C_0 Value: I2C0 channel selection for - I2C_0.
        enumeration rba_I2c_SlaveSpeed [0..1]: multiplicity set at pre-compile, origin=RB:v0.1.0:2013-01-22, post-build-variant-multiplicity=true, post-build-variant-value=true, set at pre-compile, default-value=NORMAL_MODE  # Slave baud rate | Slave speed parameter configuration is not Mandatory for the rba_I2c_SlaveConfig container.. This configuration is Selection of speed range for slave device that communicating with I2C. Normal mode is 100KHz and Fast mode is 400KHz If not configured the parameter, default setting will be taken as Normal speed(100KHz) Configuration allowed: NORMAL_MODE FAST_MODE Value:  NORMAL_MODE
          NORMAL_MODE  # Normal
          FAST_MODE  # Fast
        container rba_I2c_SequenceConfig [1..*]: multiplicity set at pre-compile, post-build-variant-multiplicity=true  # Sequence config | Sequence configuration container is dataset is a Mandatory for the I2C configuration. Sequence configuration container this is connected to I2C slave module. Sequence configuration provide multiple option for the I2C slave-interface. Sequence Id name is specified by the containers short name. ( Mandatory Container )-If not available I2C interface will be disable. Configuration hint: short name like rba_I2c_SequenceConfig_xxx Value: Ex for sequence rba_I2c_SequenceConfig_0
          function name rba_I2c_SequenceEndNotification [0..1]: multiplicity set at pre-compile, origin=RB:3.0.0:2014-06-24, post-build-variant-multiplicity=true, post-build-variant-value=true, set at pre-compile, default-value=NULL_PTR  # Sequence end notification | Sequence End Notification parameter Configuration not Mandatory for the rba_I2c_SequenceConfig container. This parameter is a reference to a notification function called at the end of the Sequence (call-back function). The signature of the function must be void(void).
          string rba_I2c_SequenceEndNotificationHeaderName [0..1]: multiplicity set at pre-compile, origin=RB:v1.37.0:2019-04-12, post-build-variant-multiplicity=true, post-build-variant-value=true, set at pre-compile  # Header file name | Optional reference to a header file, in which the declaration of the configured signal notification function is located. if declaration is in "Xxx.h" header file, just enter "Xxx". If not configured, notification function declaration will be generated in rba_I2C_Prv.h
          enumeration rba_I2c_SequenceInterface: origin=RB:v0.1.0:2013-01-22, post-build-variant-value=true, set at pre-compile, default-value=RBA_I2C_SEQ_TRANSMIT  # Sequence interface type | Sequence interface parameter Configuration is Mandatory for the rba_I2c_SequenceConfig container.This Sequence interface method select he interface type of slave. Configuration allowed: RBA_I2C_SEQ_TRANSMIT RBA_I2C_SEQ_RECEIVE RBA_I2C_SEQ_TRANSMIT_RECEIVE Value: for transmit RBA_I2C_SEQ_TRANSMIT
            RBA_I2C_SEQ_TRANSMIT  # TRANSMIT
            RBA_I2C_SEQ_RECEIVE  # RECEIVE
            RBA_I2C_SEQ_TRANSMIT_RECEIVE  # TRANSMIT & RECEIVE
          enumeration rba_I2c_SequencePriority [0..1]: multiplicity set at pre-compile, origin=RB:v0.1.0:2013-01-22, post-build-variant-multiplicity=true, post-build-variant-value=true, set at pre-compile, default-value=RBA_I2C_SEQ_LOW_PRIORITY  # Sequence priority | Sequence Priority parameter Configuration not Mandatory for the rba_I2c_SequenceConfig container.This configuration parameter decide the Sequence Priority setting(High Priority or Low Priority ). IF configuration is not present software will consider Default value as Low Priority. Configuration allowed: RBA_I2C_SEQ_HIGH_PRIORITY RBA_I2C_SEQ_LOW_PRIORITY Value: low priority configuration for RBA_I2C_SEQ_HIGH_PRIORITY
            RBA_I2C_SEQ_HIGH_PRIORITY  # HIGH_PRIORITY
            RBA_I2C_SEQ_LOW_PRIORITY  # LOW_PRIORITY
          integer rba_I2c_SequenceRxLength: 0..32, origin=RB:0.3.0:2012-07-27, post-build-variant-value=true, set at pre-compile, default-value=0  # Sequence receive length | Receive length parameter is a Mandatory for the rba_I2c_SequenceConfig container. This configuration is decide the Sequence Receive length. for the receive sequence configuration Receive length should be '1' - '32' Value: Ex:length '5'
          integer rba_I2c_SequenceTxLength: 0..32, origin=RB:0.3.0:2012-07-27, post-build-variant-value=true, set at pre-compile, default-value=0  # Sequence transmit length | Transmit length paramenr is Mandatory configset for the rba_I2c_SequenceConfig container. This configuration is decide the Sequence Transmit length. for the transmit sequence configuration Transmit length should be '1' - '32' Value: Ex:length '5'
    container rba_I2c_General [0..1]: multiplicity set at pre-compile  # General setting | General setting container is not Mandatory configuration set for I2C configuration. General setting for the I2C module. ( Mandatory Container )-If not available I2C interface will be disable. Configuration hint: short name like rba_I2c_General
      boolean rba_I2c_DevErrorDetect [0..1]: multiplicity set at pre-compile, origin=RB:0.1.0:2012-10-19, set at pre-compile, default-value=true  # Development error detection | Device error detection parameter is not Mandatory for rba_I2c_General container. This configuration will help to select the Switches the Development Error Detection and Notification ON or OFF. Configuration allowed: true: Enabled. false: Disabled. Value: Ex:DET enable true
      boolean rba_I2c_VersionInfoApi [0..1]: multiplicity set at pre-compile, origin=RB:0.1.0:2012-10-19, set at pre-compile, default-value=true  # Enable rba_I2c_GetVersionInfo | Get Version info Api parameter is not Mandatory for rba_I2c_General container. This configuration will help to select the Adds / removes the service GetVersionInfo from the code. Configuration allowed: true: Enabled false: Disabled. Value: Ex:Getversion support enable true

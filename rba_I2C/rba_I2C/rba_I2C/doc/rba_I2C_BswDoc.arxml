AUTOSAR XML (schema 4-0-3)
package /RB/RBA/rba_I2c/BswModuleDescriptions
  bsw module description rba_I2c  # Inter-Integrated Circuit Communication
    sw-component-documentation:
      sw feature def BswDocDef
        5 x chapter:
          BswDocDefPurpose: p=l-1=The component rba_I2c provides the transport layer for peripheral devices (IoExtDev) connected to the I2C interface. This allows the Transmit and Receive data from peripheral external devices. Post build configuration support also available., p=l-1=(Controller support)IFX and JDP basic function feature is implemented for Interrupt and Polling service request enabled.  # Purpose
          BswDocDefIntroduction:  # Introduction
            p=l-1=This document specifies the functionality of Basic Software module Inter-Integrated Circuit driver (I2C).
            p=l-1=The I2C interface functional It is used to synchronize all data transfers over the I2C bus 2.0 standard.
            p=l-1=An (Inter-Integrated Circuit) rba_I2c driver belongs to the Micro controller Abstraction Layer (MCAL), external I2c devices are interface with the micro controller
            p=l-1=This module create the interaction between External device software module (Ex:IO_ExtPort) and External device Hardware
            p=l-1=via this communication driver .
            p=l-1=fro I2C module configuration is required 1. I2C-General setting 2.Slave configuration 3.IFX port setting 4.Ecum init configuration 5.ISR configuration 6.Port configuration.
            p=l-1=1. General setting configuration is related to the I2C protocol setting.
            p=l-1=2. Slave configuration is related to (slave)Io_External device setting for the I2C interface.
            p=l-1=3. IFX port configuration is only for the IFX controller using the project. This setting is help fro the I2C interface port pin selection.
            p=l-1=4. I2C-init function configuration setting required in ECUM init-Proc.
            p=l-1=5. I2C-ISR configuration required in rba_OsShell.
            p=l-1=6. I2C interface hardware port pin setting in port module.
            p=l-1=for complete configuration info please refer the configuration hint doc .
            p=l-1=I2C limitation:
            p=l-1=IFX interrupt mode support 1kb data tranfer in single sequence transfer at Interrupt mode.
            figure l-graphic={short-label=Architecture_dia, category=GRAPHIC}:
              figure caption Architecture_dia  # rba_I2c Architecture Dia
          BswDocDefInteraction:  # Interaction
            p=l-1=Essential Interface Package for the I2C communication:
            p=l-1=--------ESM/EcuM : This pack is required for the I2C init function call interface.
            p=l-1=--------BswLib/rba_BswSrv : This pack is required for enabling the SPIN lock and Global interrupt disable.
            p=l-1=--------BswLib/rba_MemLay : This pack is required for Memory section enable.
            p=l-1=--------Diagnosis/Det : This pack is required for Development error detection enable.
            p=l-1=--------EbOs/rba_OsShell : This pack is required for Wakeup the ISR enable.
            p=l-1=An (Inter-Integrated Circuit) rba_I2c driver belongs to the Micro controller Abstraction Layer (MCAL), external I2c devices are interface with the micro controller
            p=l-1=via this communication driver .
            figure l-graphic={short-label=Interface_Dia, category=GRAPHIC}:
              figure caption Interface_Dia  # rba_I2c module interface Dia
          BswDocDefFeatures:  # Features
            p=l-1=The I2C provides communication between micro controller and external peripheral I2C Slave devices. Micro controller act as a Master (Single Master mode),External peripheral I2c standard device act as Slave .
            p=l-1=I2C Communication between master and slave is bi-directional.
            p=l-1=The I2C communication supports the standard mode(100KHz) and fast mode(400kHz) speed.
            p=l-1=Master interfaces to slave with 7 bit, unique addressing mechanism for each slave device.
            p=l-1=Software Supports multiple I2C channel in single controller( Ex: I2C0, I2C1 ) .
            p=l-1=Before enable Global interrupt working in POLLING mode.
            p=l-1=After enable Global interrupt, working in interrupt mode.
            p=l-1=Save request are handling in Queue mechanism.
            p=l-1=Sequence Failure status are send to DET execution.
            p=l-1=Sequence callback function enable(Sequence end notification).
            p=l-1=Sequence Priority setting enable (Sequence end notification).
          BswDocDefSubstructure  # Substructure
      sw feature desc BswDocDesc
        chapter BswDocDescBehaviorNormalMode:  # Behavior in normal mode
          p=l-1=This I2C communication interface will Read or Write request from the application module.
          p=l-1=store the sequence in to the Queue FIFO method. This function Checks the status of I2C handler, whether if it is free, this function will trigger the Handler function for complete the sequence.
          p=l-1=Application request are updated in to the queue and Handler will Read the request from the queue and send to slave Hardware.
        chapter BswDocDescBehaviorInitialization: p=l-1=Init function initializes the hardware channels Initializes the communication mode to master mode., p=l-1=Sets the default communication to IDLE mode  # Behavior in initialization
        chapter BswDocDescBehaviorShutdown: p=l-1=This process will support the shut-down process, during Os shut-down all the configured I2C channels are disabled. This interface disables all I2C Hardware modules and corresponding Queues completes the sequences in the queue after which queue state will be set to inactive state. This interface sets the I2C module hardware setting to the IDLE mode, and resets to the default state.  # Behavior in shut-down
      sw calibration notes BswDocCalibration
        chapter BswDocCalibrationMeasurements  # Measurements
        chapter BswDocCalibrationParameters: p=l-1=I2c provides no calibration features.  # Calibration parameters
      9 x chapter:
        BswDocGlossary  # Glossary
        BswDocArDeviations  # Deviations from AUTOSAR specification
          chapter BswDocArDeviationsPermanent  # Permanent deviations
          chapter BswDocArDeviationsTemporary  # Temporary deviations
        BswDocInterfaces  # Interface reference
          5 x chapter:
            BswDocInterfaceEcuc: p=l-1=I2C interface is not mandatory configuration for the Mcal, if the I2C slave device is present then only the configurations are require., p=l-1=I2C master and slave configuration are following General configuration,Slave configuration., p=l-1=Configuration hint document present in the Mcal->I2C->doc floder., p=l-1=for the I2C configuration refer the "rba_I2C_Configuration_Hint.doc" document.  # Configuration interface
            BswDocInterfaceCalibration  # Calibration interface
              chapter BswDocInterfaceCalibrationMeasurements: p=l-1=I2C initialization status :rba_I2c_stInitialized_b  # Measurements
              chapter BswDocInterfaceCalibrationParameters: p=l-1=-  # Calibration parameters
            BswDocInterfaceRte  # RTE interface
              6 x chapter:
                BswDocInterfaceRteClientServer  # Client/server interfaces
                BswDocInterfaceRteData  # Data interfaces
                BswDocInterfaceRteModeSwitch  # Mode switch interfaces
                BswDocInterfaceRteTrigger  # Trigger interfaces
                BswDocInterfaceRtePPorts  # Provided ports
                BswDocInterfaceRteRPorts  # Required ports
            BswDocInterfaceC  # C interface
              7 x chapter:
                BswDocInterfaceCProvidedFunctions:  # Provided functions
                  p=l-1=I2c interface will support the read and write sequence to the external module (Slave device)
                  p=l-1=I2C -INTERFACE(GLOBAL)
                  p=l-1=**** 1. I2C-INIT : "ECUM" module call (provides) services for initialization the I2C communication.
                  p=l-1=**** 2. I2C-END-INIT : End of the Global Interrutp activation, OS will call services to the I2C and enable the I2C communication interrupt in status variable.
                  p=l-1=**** 3. I2C-TRANSMIT and RECEIVE : External Device module call(request) the I2C communication to support salve device for Transmit and Receive interface.
                  p=l-1=**** 4. I2C-DEINIT : services for un-initialization the I2C communication.
                  p=l-1=I2C-INIT, I2C-END-INIT, I2C-DEINIT services for the configurations are required.
                  p=l-1=I2C-TRANSMIT and RECEIVE service for slave divice configuration, and general settings are required
                  p=l-1=I2C communication support the Interrupt mode and Polling mode.
                  p=l-1=Polling Mode :
                  p=l-1=--------before enable the Global interrupt I2C will execute in Polling mode
                  p=l-1=Interrupt mode :
                  p=l-1=--------after enable the Global interrupt and I2C-init go to the interrupt mode
                  p=l-1=void rba_I2c_Init(const rba_I2c_ConfigType *configuration_pcst)
                  p=l-1=void rba_I2c_End_Init(void)
                  p=l-1=Std_ReturnType rba_I2c_TxRx_Sequence( rba_I2c_SeqDef_tst * rba_I2c_SeqDef_st )
                  p=l-1=void rba_I2c_DeInit(void)
                  5 x chapter:
                    rba_I2c_Init:  # void rba_I2c_Init(const rba_I2c_ConfigType *configuration_pcst)
                      p=l-1=This function enable the I2C hardware setting and create the global variables for rba_I2C and initiate the queue as per the configuration size.
                      p=l-1=This function get the address of the Postbuild dataset,Initializes and handles the post-condition settings for I2C communication,
                      p=l-1=hence init process shall vary based on the number of Configured I2C modules.
                      p=l-1=Also the rba_I2C configuration of the ASW will be set.
                      table tgroup=tbody=[[p=l-1=e=Service Name, p=l-1=rba_I2c_Init], [p=l-1=e=Signature, p=l-1=void rba_I2c_Init(const rba_I2c_ConfigType *configuration_pcst)], [p=l-1=e=Service ID, p=l-1=0x01], [p=l-1=e=Usage, p=l-1=public], [p=l-1=e=Sync/Async, p=l-1=Synchronous], [p=l-1=e=Reentrancy, p=l-1=non-reentrant], [p=l-1=e=Parameters [in], p=l-1=configuration_pcst], [p=l-1=e=Parameters [out], p=l-1=-], [p=l-1=e=Return value, p=l-1=void], [p=l-1=e=Header file, p=l-1=rba_I2C.h], [p=l-1=e=Configuration Dependency, p=l-1=none], [p=l-1=e=Description, p=l-1=initilize the I2C communication]]:
                        table caption rba_I2c_Init_Table  # rba_I2c_Init properties
                    rba_I2c_End_Init: p=l-1=This function part prepares the usage of the interrupt driven command queue handler and enables it., p=l-1=It shall be called after Global interrupts are enabled..  # void rba_I2c_End_Init(void)
                      table tgroup=tbody=[[p=l-1=e=Service Name, p=l-1=rba_I2c_End_Init], [p=l-1=e=Signature, p=l-1=void rba_I2c_End_Init(void)], [p=l-1=e=Service ID, p=l-1=0x06], [p=l-1=e=Usage, p=l-1=public], [p=l-1=e=Sync/Async, p=l-1=Synchronous], [p=l-1=e=Reentrancy, p=l-1=non-reentrant], [p=l-1=e=Parameters [in], p=l-1=-], [p=l-1=e=Parameters [out], p=l-1=-], [p=l-1=e=Return value, p=l-1=void], [p=l-1=e=Header file, p=l-1=rba_I2C.h], [p=l-1=e=Configuration Dependency, p=l-1=none], [p=l-1=e=Description, p=l-1=Enble the interrupt mode in I2C communication]]:
                        table caption rba_I2c_End_Init_FuncTable  # rba_I2c_End_Init properties
                    rba_I2C_MoInitCheck  # Std_ReturnType rba_I2C_MoInitCheck(const rba_I2c_ConfigType *configuration_pcst)
                      table tgroup=tbody=[[p=l-1=e=Service Name, p=l-1=rba_I2C_MoInitCheck], [p=l-1=e=Signature, p=l-1=Std_ReturnType rba_I2C_MoInitCheck(const rba_I2c_ConfigType *configuration_pcst)], [p=l-1=e=Service ID], [p=l-1=e=Usage, p=l-1=public], [p=l-1=e=Sync/Async, p=l-1=Synchronous], [p=l-1=e=Reentrancy, p=l-1=Reentrant], [p=l-1=e=Parameters [in], p=l-1=configuration_pcst : Pointer to the selected configuration dataset], [p=l-1=e=Parameters [out], p=l-1=-], [p=l-1=e=Return value, [l-1=Std_ReturnType, l-1=E_OK : If input pointer is identical to configured postbuild pointer., l-1=E_NOT_OK: In case the pointers are different from one another.]], [p=l-1=e=Header file, p=l-1=rba_I2C.h], [p=l-1=e=Configuration Dependency, p=l-1=none], [p=l-1=e=Description, p=l-1=This function is for MONITORING components (MoF) only. A Service to compare the postbuild pointer which has been set during init with the input pointer as a direct access to Mcal]]:
                        table caption rba_I2C_MoInitCheck_FuncTable  # rba_I2C_MoInitCheck properties
                    rba_I2c_TxRx_Sequence:  # Std_ReturnType rba_I2c_TxRx_Sequence( rba_I2c_SeqDef_tst * rba_I2c_SeqDef_st )
                      p=l-1=This function will be called by the application to read/write request. These requests will load in the queue (read or Write).Queue size will depend on number of slave configuration. Each slave request occupies one position in the queue.
                      p=l-1=Function will always append the data to end of the Queue.
                      p=l-1=It checks the Maximum buffer level, if the buffer level exceed the Maximum level then it will not allow to add request to Queue.
                      p=l-1=After successful entry of information under queue, the queue status variable will update in to the FreePosition and number of Entries. If interrupt is disable call the synchronous handler function.
                      p=l-1=It shall be called after interrupts are enabled..
                      table tgroup=tbody=[[p=l-1=e=Service Name, p=l-1=rba_I2c_TxRx_Sequence], [p=l-1=e=Signature, p=l-1=Std_ReturnType rba_I2c_TxRx_Sequence( rba_I2c_SeqDef_tst * rba_I2c_SeqDef_st )], [p=l-1=e=Service ID, p=l-1=0x04], [p=l-1=e=Usage, p=l-1=public], [p=l-1=e=Sync/Async, p=l-1=Synchronous], [p=l-1=e=Reentrancy, p=l-1=reentrant], [p=l-1=e=Parameters [in], p=l-1=rba_I2c_SeqDef_st : trasfer message stracture], [p=l-1=e=Parameters [out], p=l-1=Std_ReturnType], [p=l-1=e=Return value, [l-1=uint32:, l-1=- E_OK: sequeness suess, l-1=- E_NOT_OK: sequence failed]], [p=l-1=e=Header file, p=l-1=rba_I2C.h], [p=l-1=e=Configuration Dependency, p=l-1=none], [p=l-1=e=Description, p=l-1=slave Request for Transmit or Receive]]:
                        table caption rba_I2c_TxRx_SequenceTable  # rba_I2c_TxRx_Sequence properties
                    rba_I2c_DeInit:  # void rba_I2c_DeInit(void)
                      p=l-1=This function is used to uninitialized the I2C module. This function till wait for completion of current entry in to the Queue, and Change the Queue state to Disable state.
                      p=l-1=we can not access the I2C Queue after this function call. This function set the communication bus to Idle.I2C registers are going to default state.
                      p=l-1=It shall be called after interrupts are enabled..
                      p=l-1=\param: none
                      p=l-1=\return: none
                      table tgroup=tbody=[[p=l-1=e=Service Name, p=l-1=rba_I2c_DeInit], [p=l-1=e=Signature, p=l-1=void rba_I2c_DeInit(void)], [p=l-1=e=Service ID, p=l-1=0x03], [p=l-1=e=Usage, p=l-1=public], [p=l-1=e=Sync/Async, p=l-1=Synchronous], [p=l-1=e=Reentrancy, p=l-1=non-reentrant], [p=l-1=e=Parameters [in], p=l-1=void], [p=l-1=e=Parameters [out], p=l-1=void], [p=l-1=e=Return value, p=l-1=-], [p=l-1=e=Header file, p=l-1=rba_I2C.h], [p=l-1=e=Configuration Dependency, p=l-1=none], [p=l-1=e=Description, p=l-1=Request for te shutdown phase]]:
                        table caption rba_I2c_DeInitTable  # rba_I2c_DeInit properties
                BswDocInterfaceCOutgoingCallbacks  # Outgoing callbacks
                BswDocInterfaceCMacros  # Macros
                BswDocInterfaceCPreproc  # Preprocessor constants
                BswDocInterfaceCDataTypes  # Data types
                BswDocInterfaceCConstants  # Constants
                BswDocInterfaceCVariables:  # Variables
                  p=l-1=Global I2C sequene structure which contains several sequene specific data:
                  p=l-1=rba_I2c_SeqDef_tst rba_I2c_SeqDef_st:
                  list=[p=l-1=rba_I2c_SeqDef_st.rba_I2c_dataTxlength_u8: sequence Transmit data Length, p=l-1=rba_I2c_SeqDef_st.rba_I2c_dataRxlength_u8: sequence Receive data Length, p=l-1=rba_I2c_SeqDef_st.rba_I2c_dataRx_pu8: sequence Receive data pointer, p=l-1=rba_I2c_SeqDef_st.rba_I2c_dataTx_pu8: sequence Transmit data pointer, p=l-1=rba_I2c_SeqDef_st.rba_I2c_xComType_en: sequence Communication Type (ex: Read or write), p=l-1=rba_I2c_SeqDef_st.rba_I2c_xComErr_u8: Sequence process Error Status, p=l-1=rba_I2c_SeqDef_st.rba_I2c_xSlaveCfgId_en: Sequence configured signal ID, p=l-1=rba_I2c_SeqDef_st.rba_I2c_xSeqStatus_en: sequence process status]
            BswDocInterfaceSched  # Scheduling interface
        BswDocEnvNeeds  # Environment needs
          5 x chapter:
            BswDocEnvNeedsDemEvents: p=l-1=configure the I2C Data transfer interrupt ., p=l-1=IFX interrupt for we have use the unique priority ID, p=l-1=JDP interrupt for repeat priority ID support, p=l-1=No DEM events have to be configured for this component.  # Dem events
            BswDocEnvNeedsDetEvents: p=l-1=Hardware connected Port Pins are configured to I2C interface, p=l-1=Configuration of output port function with open drain mode for the communication.  # Det events
            BswDocEnvNeedsNvBlocks  # Non-volatile memory blocks
            BswDocEnvNeedsExclAreas: p=l-1=schedule manager configuration is not required.  # Exclusive areas
            BswDocEnvNeedsMemMap  # Memory mapping
        BswDocDependencies  # Dependencies
          4 x chapter:
            BswDocDependenciesCompPac:  # Other components/packages
              p=l-1=The I2C driver/handler uses the following components (direct dependency relevant for build):
              list=[p=l-1=Det (to report develpment errors), p=l-1=Mcu (for machine type), p=l-1=rba_Reg (for register headers)]
              p=l-1=Additionally there are indirect dependencys to the following modules which are required for proper operation:
              list=[p=l-1=Port (to configure the required port pins to the desired functionality with a suitable driver characteristic), p=l-1=EcuM (for initialisation with post build support), p=l-1=Os (for scheduling of processes and ISRs), p=l-1=Memmap header added for memory alignment]
              p=l-1=The I2c driver has receiving dependencies to device drivers using the I2C bus such like:
              list=item=p=l-1=rba_IoExtPort
            BswDocDependenciesSw: p=l-1=See package documentation.  # Software environment
            BswDocDependenciesHw: p=l-1=See package documentation.  # Hardware environment
            BswDocDependenciesTools: p=l-1=See package documentation.  # Tool environment
        BswDocVariants  # Variant handling
          chapter BswDocVariantsSysConst  # System constants
          chapter BswDocVariantsFileSelection  # File selection
          chapter BswDocVariantsTemplCust  # Template customization
            chapter rba_IoDiagAdapt_Cfg_h_tpl: p=l-1=In this manually configured template file the following #define has to be configured:  # Template file rba_IoDiagAdapt_Cfg.h_tpl
              table tgroup={thead=row=[p=l-1=Define name, p=l-1=Values, p=l-1=Description], tbody=[[p=l-1=RBA_I2C_CFG_DEV_ERROR_DETECT, p=l-1=STD_ON, p=l-1=Activates the report of development errors to the DET .], [p=l-1=STD_OFF, p=l-1=Deactivates the report of development errors to the DET.]]}:
                table caption DET_Configuration  # Configuration of RBA_I2C_CFG_DEV_ERROR_DETECT
        BswDocIntegration  # Integration
          4 x chapter:
            BswDocIntegrationEffort: p=l-1=Medium effort is required for integration. Especially because of the interrupt configuration.  # Estimated effort
            BswDocIntegrationHowTo: p=l-1=The following steps are necessary for successful integration of the I2C driver:, list=[p=l-1=Add component rba_I2c. Typically this is included in the Mcal package., p=l-1=Configure rba_I2c for connection of I2C devices(Ex: IO_ExtPort )., p=l-1=Configure rba_I2c for general setting to communicatin properties., p=l-1=Configure rba_I2c for connection of I2C devices., p=l-1=Configure Port for required interface port pins., p=l-1=Configure EcuM to call initialization functions., p=l-1=Configure Os for processes and ISRs (see below in chapter "Scheduled functions")., p=l-1=void rba_I2c_Init(const rba_I2c_ConfigType *configuration_pcst) function call need to add under the ECUM init section., p=l-1=void rba_I2c_End_Init(void) function call need to add under the OS shudele under the OS_BswStart_Ini_Task., p=l-1=I2C interface atlest one slave config and one sequence config is required ., p=l-1=Slave config must be link to the sequence config., p=l-1=without slave configuration I2C module will be disable ., p=l-1=Enable Memmap section for configure rba_I2C_Cfg_MemMap.h set to "RBA_I2C_ENABLE_MEMMAP"-> STD_ON .]  # How to integrate
              chapter Port_Configuration: p=l-1=All port pins used by I2C must be configured in the Port module according to the Port Assignment provided by the HW team. For Ifx Dev5 40nm A-step, the pad driver setting should be "medium driver" to avoid potential spikes on SCL output.  # Configuration of Port
              chapter EcuM_Configuration: p=l-1=EcuM must be configured to call rba_I2c_Init() with the desired post build variant.  # Configuration of EcuM
            BswDocIntegrationSched  # Scheduling aspects
            BswDocIntegrationBuild: p=l-1=See package documentation.  # Build aspects
        BswDocUseCases  # Use cases
        BswDocMisc:  # Miscellaneous
          p=l-1=In the configuration of Transmit sequence also configure the Transmit and receive length is required. Need to mention the Receive length is zero. .
          p=l-1=In the configuration of Receive sequence also configure the Transmit and receive length is required. Need to mention the Transmit length is zero.
          p=l-1=while tesing the IFX controller we should donâ€™t open the TXD and RXD register, otherwise we will get the Receiver under flow error. .
          p=l-1=IFX Dev3 support maximum Transmit data size is 4 byte single shot. IFX Dev3 A type controller will not support double buffer transfer method.
          p=l-1=supporting clock speed 400Khz and 100Khz.
          p=l-1=Depend the Slave clock stech I2C communication (master) clock will be (Adjust) vary the configuration speed.
          p=l-1=..
          p=l-1=e7109: I2C: In master receive mode, data remains latched in I2C data I/O register (IBDR) until new data is received
          p=l-1=for this errata every read by need to be different for the (only JDP controller) from the slave device

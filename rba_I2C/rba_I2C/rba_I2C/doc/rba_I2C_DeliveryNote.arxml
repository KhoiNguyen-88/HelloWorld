AUTOSAR XML (schema 4-0-3)
package /rba_I2C/Documentations
  documentation DeliveryNote: category=ARREP  # Delivery Note
    documentation-content:
      4 x chapter:
        DeliveryNoteGeneral: category=BODY  # General delivery information
          table tgroup=tbody=[[p=l-1=e=Delivery date:, p=l-1=2019-30-04], [p=l-1=e=Abstract of changes:, p=l-1=RQONE01674143 - Enhanced callback notification support.], [p=l-1=e=Restrictions:], [p=l-1=e=Supported devices:, p=l-1=See Mcal delivery note], [p=l-1=e=Process baseline:, p=l-1=DGS-EC Process Library V4.10.1], [p=l-1=e=Developer:, p=l-1=Mohaseena A (RBEI/EBB6)], [p=l-1=e=Requirements to:, p=l-1=Thillai Maharajan M (RBEI/EBB)]]:
            table caption DeliveryNoteGeneralInfo  # General delivery information
        DeliveryNoteChanges  # Changes
          table tgroup={thead=row=[p=l-1=Id, p=l-1=Headline], tbody=row=[p=l-1=RQONE01674143, p=l-1=Enhanced callback notification support.]}:
            table caption DeliveryNoteChangesTable
        DeliveryNoteDeprecated  # Deprecated functionality
          chapter DeliveryNoteUpdateTools: list=item=p=l-1=AEEE-Pro 2018.2.0  # Necessary tool versions
        DeliveryNoteAdditional  # Additional hints

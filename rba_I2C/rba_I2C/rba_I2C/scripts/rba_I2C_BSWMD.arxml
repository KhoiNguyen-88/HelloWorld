AUTOSAR XML (schema 4-2-2)
package /RB/RBA/rba_I2c/BswImplementations
  bsw implementation rba_I2c: programming-language=C, sw-version=4.31.0, ar-release-version=4.2.2, behavior=BswInternalBehavior, vendor-specific-module-def=rba_I2c
    code-descriptors:
      code CodeDescriptor: artifact-descriptors=autosar-engineering-object={short-label=ArEngObj, category=SWSRC}
package /RB/RBA/rba_I2c/BswModuleDescriptions
  bsw module description rba_I2c: category=BSW_MODULE, module-id=254, provided-entrys=[rba_I2c_Init, rba_I2c_End_Init]
    bsw internal behavior BswInternalBehavior
      bsw called entity rba_I2c_Init: implemented-entry=rba_I2c_Init
      bsw called entity rba_I2c_End_Init: implemented-entry=rba_I2c_End_Init
package /RB/RBA/rba_I2c/BswModuleEntrys
  bsw module entry rba_I2c_Init: service-id=0, is-reentrant=false, is-synchronous=true, call-type=REGULAR, execution-context=UNSPECIFIED, sw-service-impl-policy=STANDARD  # rba_I2c Initialization Function
    sw service arg configuration_pcst: category=DATA_REFERENCE, direction=IN, implementation-data-type=rba_I2c_ConfigType  # pointer to selected postbuild data set
  bsw module entry rba_I2c_End_Init: service-id=1, is-reentrant=false, is-synchronous=true, call-type=REGULAR, execution-context=UNSPECIFIED, sw-service-impl-policy=STANDARD
package /RB/RBA/rba_I2c/ImplementationDataTypes
  8 x impl type, all with type-emitter=rba_I2c:
    rba_I2c_xComType_ten: implementation-data-type=uint8
    rba_I2c_Port_ten: implementation-data-type=uint8
    rba_I2c_SlaveBaudType_ten: implementation-data-type=uint8
    rba_I2c_PriorityType_ten: implementation-data-type=uint8
    rba_I2c_Cfg_Slave_tst: category=STRUCTURE
      element hwConnectID_u8: implementation-data-type=uint8
      element slaveAddress_u8: implementation-data-type=uint8
      element baudRate_en: implementation-data-type=rba_I2c_SlaveBaudType_ten
    rba_I2c_Cfg_Sequence_tst: category=STRUCTURE
      6 x element:
        xSeqEndNotif_pfct: category=DATA_REFERENCE, sw-pointer-target-props={target-category=VALUE, base-type=void}
        sequPrio_en: implementation-data-type=rba_I2c_PriorityType_ten
        seqComType_en: implementation-data-type=rba_I2c_xComType_ten
        seqTxLen_u8: implementation-data-type=uint8
        seqRxLen_u8: implementation-data-type=uint8
        SlaveId: implementation-data-type=uint8
    rba_I2c_Cfg_HwUnit_tst: category=STRUCTURE
      element LogicHwId_u8: implementation-data-type=uint8
      element hwPort_u8: implementation-data-type=rba_I2c_Port_ten
    rba_I2c_ConfigType: category=STRUCTURE
      4 x element, all with category=TYPE_REFERENCE:
        numberOfUnits_u8: implementation-data-type=uint8
        slaveConfig_pcst: implementation-data-type=rba_I2c_Cfg_Slave_tst
        hwUnitConfig_pcst: implementation-data-type=rba_I2c_Cfg_HwUnit_tst
        sequenceConfig_pcst: implementation-data-type=rba_I2c_Cfg_Sequence_tst
